/* R80 ET_REL exact coalescing; no final VMA/LMA or padding claim. */
SECTIONS {
 .rodata.tsl9_r78_union_1a18c 0x1A18C : {
  KEEP(*(.rodata.tsl9_r78_fragment_1a18c))
  KEEP(*(.rodata.tsl9_ro_window_1a1b0))
  KEEP(*(.rodata.tsl9_r78_fragment_1a1bf))
  KEEP(*(.rodata.tsl9_ro_window_1a1c0))
  KEEP(*(.rodata.tsl9_r78_fragment_1a1cf))
  KEEP(*(.rodata.tsl9_ro_window_1a1d0))
  KEEP(*(.rodata.tsl9_r78_fragment_1a1df))
  KEEP(*(.rodata.tsl9_r79_switch_1a1e0))
  KEEP(*(.rodata.tsl9_r79_switch_1a224))
  KEEP(*(.rodata.tsl9_ro_window_1a240))
  KEEP(*(.rodata.tsl9_r78_fragment_1a244))
  KEEP(*(.rodata.tsl9_ro_window_1a248))
  KEEP(*(.rodata.tsl9_r78_fragment_1a24f))
  KEEP(*(.rodata.tsl9_ro_window_1a250))
  KEEP(*(.rodata.tsl9_r78_fragment_1a263))
  KEEP(*(.rodata.tsl9_ro_window_1a264))
  KEEP(*(.rodata.tsl9_r78_fragment_1a269))
  KEEP(*(.rodata.tsl9_ro_window_1a26c))
  KEEP(*(.rodata.tsl9_r78_fragment_1a277))
  KEEP(*(.rodata.tsl9_ro_window_1a278))
  KEEP(*(.rodata.tsl9_r78_fragment_1a27d))
  KEEP(*(.rodata.tsl9_ro_window_1a280))
  KEEP(*(.rodata.tsl9_r78_fragment_1a284))
  KEEP(*(.rodata.tsl9_ro_window_1a288))
  KEEP(*(.rodata.tsl9_r78_fragment_1a295))
  KEEP(*(.rodata.tsl9_ro_window_1a298))
 }
 .rodata.tsl9_r80_union_1a2d0 0x1A2D0 : {
  KEEP(*(.rodata.tsl9_r80_fragment_1a2d0))
  KEEP(*(.rodata.tsl9_r79_callback_1a300))
  KEEP(*(.rodata.tsl9_r79_callback_1a30c))
  KEEP(*(.rodata.tsl9_mode_table_1a318))
  KEEP(*(.rodata.tsl9_ro_window_1a334))
  KEEP(*(.rodata.tsl9_r80_fragment_1a338))
  KEEP(*(.rodata.tsl9_dispatch_mode_table_1a33c))
  KEEP(*(.rodata.tsl9_dispatch_bits_table_1a358))
  KEEP(*(.rodata.tsl9_service_table_1a378))
  KEEP(*(.rodata.tsl9_r78_fragment_1a76c))
  KEEP(*(.rodata.__tsl9_jump_table_1a788))
  KEEP(*(.rodata.tsl9_ro_window_1a7a0))
  KEEP(*(.rodata.tsl9_r78_fragment_1a7b5))
  KEEP(*(.rodata.tsl9_ro_window_1a7d0))
  KEEP(*(.rodata.tsl9_r78_fragment_1a7e0))
 }
}
ASSERT(SIZEOF(.rodata.tsl9_r78_union_1a18c) == 274, "R80 exact coalesced size")
ASSERT(SIZEOF(.rodata.tsl9_r80_union_1a2d0) == 2204, "R80 exact coalesced size")
