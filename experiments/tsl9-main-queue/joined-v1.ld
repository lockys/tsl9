/* Actual queue/receive C/C++ bodies; duplicate disarm is supplied by parent. */
SECTIONS {
 .boot_code 0 : SUBALIGN(1) {
  *(.boot_code)
  *(.provider_clear_code)
  *(.text.tsl9_queue_external_82d2)
  *(.text.tsl9_filter_scan_8308)
  *(.text.tsl9_filter_pack_8328)
  *(.text.tsl9_filter_emit_8358)
  *(.text.tsl9_filter_test_836a)
  *(.text.tsl9_filter_finish_836e)
  *(.text.tsl9_filter_second_838a)
  *(.text.tsl9_filter_external_8a56)
  *(.text.tsl9_transport_frame_8a5e)
  *(.text.tsl9_transport_first_8a7a)
  *(.text.tsl9_transport_first_result_8a90)
  *(.text.tsl9_transport_second_8a96)
  *(.text.tsl9_transport_second_result_8ab6)
  *(.text.tsl9_transport_reject_8abe)
  *(.text.tsl9_transport_select0_8acc)
  *(.text.tsl9_transport_pack_8ace)
  *(.text.tsl9_transport_test_8b0a)
  *(.text.tsl9_transport_finish_8b14)
  *(.text.tsl9_transport_copy_8b52)
  *(.text.tsl9_transport_bare_return_8b6c)
  *(.text.tsl9_program_arm_93aa)
  *(.text.tsl9_program_arm_body_93c0)
  *(.text.tsl9_program_arm_return_93ec)
  *(.text.tsl9_program_allocate_9410)
  *(.text.tsl9_program_old_pointer_941e)
  *(.text.tsl9_program_free_9424)
  *(.text.tsl9_program_cleanup_942c)
  *(.text.tsl9_program_allocate_tail_943e)
  *(.text.tsl9_queue_external_9454)
  *(.text.tsl9_program_small_9464)
  *(.text.tsl9_program_prepare_9472)
  *(.text.tsl9_program_test_948e)
  *(.text.tsl9_program_finish_9492)
  *(.text.tsl9_program_restore_tail_949e)
  *(.text.tsl9_program_fill_94a8)
  *(.text.tsl9_program_large_94be)
  *(.text.tsl9_program_special_94cc)
  *(.text.tsl9_program_failure_94e4)
  *(.text.tsl9_queue_external_9b36)
  *(.text.tsl9_queue_entry_12c58)
  *(.text.tsl9_queue_scan_12c86)
  *(.text.tsl9_queue_release_12ca6)
  *(.text.tsl9_queue_validate_12cb4)
  *(.text.tsl9_queue_advance_12cee)
  *(.text.tsl9_queue_finish_12cf8)
  *(.text.tsl9_queue_zero_12d0e)
  *(.text.tsl9_queue_emit_12d42)
  *(.text.tsl9_queue_response_12d4c)
  *(.text.tsl9_queue_other_12d78)
  *(.text.tsl9_register_write_entry_16a30)
  *(.text.tsl9_register_write_body)
  *(.text.tsl9_receive_buffer_entry_16a7c)
  *(.text.tsl9_packet_receive_body)
  *(.text.tsl9_packet_receive_finish_16afe)
  *(.text.tsl9_receive_entry_16b0a)
  *(.text.tsl9_receive_body)
  *(.text.tsl9_flag_consumer_entry_17002)
  *(.text.tsl9_flag_consumer_body)
  tsl9_main_provider_12c58 = tsl9_queue_entry_12c58;
  tsl9_main_provider_17002 = tsl9_flag_consumer_entry_17002;
  tsl9_queue_external_820c = tsl9_queue_clear_820c;
 }
 .initializer 0 : SUBALIGN(1) { *(.initializer) }
 .vectors 0 : SUBALIGN(1) { *(.vectors) }
}
