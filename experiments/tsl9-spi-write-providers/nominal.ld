OUTPUT_ARCH(riscv)
ENTRY(tsl9_spi_transfer_entry_16896)
SECTIONS {
  .spi_chain 0x16896 : ALIGN(2) {
    KEEP(*(.text.tsl9_spi_transfer_entry_16896))
    KEEP(*(.text.tsl9_spi_tx_poll_1689e))
    KEEP(*(.text.tsl9_spi_tx_ready_168a6))
    KEEP(*(.text.tsl9_spi_rx_poll_168b6))
    KEEP(*(.text.tsl9_spi_rx_done_168be))
    KEEP(*(.text.tsl9_spi_tx_wait_168c8))
    KEEP(*(.text.tsl9_spi_timeout_168d0))
    KEEP(*(.text.tsl9_spi_rx_wait_168d4))
    KEEP(*(.text.tsl9_tagged_external_168de))
    KEEP(*(.text.tsl9_spi_write_guard1_168e6))
    KEEP(*(.text.tsl9_spi_write_select1_168f0))
    KEEP(*(.text.tsl9_spi_write_guard2_168fa))
    KEEP(*(.text.tsl9_spi_write_select2_168fe))
    KEEP(*(.text.tsl9_spi_write_command_16908))
    KEEP(*(.text.tsl9_spi_write_address_16910))
    KEEP(*(.text.tsl9_spi_write_test_1691a))
    KEEP(*(.text.tsl9_spi_write_finish_1691e))
    KEEP(*(.text.tsl9_spi_write_payload_16932))
    KEEP(*(.text.tsl9_tagged_external_1693e))
    KEEP(*(.text.tsl9_spi_modify_guard1_16942))
    KEEP(*(.text.tsl9_spi_modify_select1_16948))
    KEEP(*(.text.tsl9_spi_modify_guard2_16952))
    KEEP(*(.text.tsl9_spi_modify_select2_16956))
    KEEP(*(.text.tsl9_spi_modify_command_16960))
    KEEP(*(.text.tsl9_spi_modify_address_1696c))
    KEEP(*(.text.tsl9_spi_modify_mask_16974))
    KEEP(*(.text.tsl9_spi_modify_value_1697c))
    KEEP(*(.text.tsl9_spi_modify_finish_16984))
  }
  /DISCARD/ : { *(.comment) *(.note*) *(.riscv.attributes) }
  ASSERT(SIZEOF(.spi_chain) == 254, "Three original adjacent providers254B")
  ASSERT(tsl9_spi_transfer_entry_16896 == 0x16896, "Original PC 16896")
  ASSERT(tsl9_spi_tx_poll_1689e == 0x1689e, "Original PC 1689e")
  ASSERT(tsl9_spi_tx_ready_168a6 == 0x168a6, "Original PC 168a6")
  ASSERT(tsl9_spi_rx_poll_168b6 == 0x168b6, "Original PC 168b6")
  ASSERT(tsl9_spi_rx_done_168be == 0x168be, "Original PC 168be")
  ASSERT(tsl9_spi_tx_wait_168c8 == 0x168c8, "Original PC 168c8")
  ASSERT(tsl9_spi_timeout_168d0 == 0x168d0, "Original PC 168d0")
  ASSERT(tsl9_spi_rx_wait_168d4 == 0x168d4, "Original PC 168d4")
  ASSERT(tsl9_tagged_external_168de == 0x168de, "Original PC 168de")
  ASSERT(tsl9_spi_write_guard1_168e6 == 0x168e6, "Original PC 168e6")
  ASSERT(tsl9_spi_write_select1_168f0 == 0x168f0, "Original PC 168f0")
  ASSERT(tsl9_spi_write_guard2_168fa == 0x168fa, "Original PC 168fa")
  ASSERT(tsl9_spi_write_select2_168fe == 0x168fe, "Original PC 168fe")
  ASSERT(tsl9_spi_write_command_16908 == 0x16908, "Original PC 16908")
  ASSERT(tsl9_spi_write_address_16910 == 0x16910, "Original PC 16910")
  ASSERT(tsl9_spi_write_test_1691a == 0x1691a, "Original PC 1691a")
  ASSERT(tsl9_spi_write_finish_1691e == 0x1691e, "Original PC 1691e")
  ASSERT(tsl9_spi_write_payload_16932 == 0x16932, "Original PC 16932")
  ASSERT(tsl9_tagged_external_1693e == 0x1693e, "Original PC 1693e")
  ASSERT(tsl9_spi_modify_guard1_16942 == 0x16942, "Original PC 16942")
  ASSERT(tsl9_spi_modify_select1_16948 == 0x16948, "Original PC 16948")
  ASSERT(tsl9_spi_modify_guard2_16952 == 0x16952, "Original PC 16952")
  ASSERT(tsl9_spi_modify_select2_16956 == 0x16956, "Original PC 16956")
  ASSERT(tsl9_spi_modify_command_16960 == 0x16960, "Original PC 16960")
  ASSERT(tsl9_spi_modify_address_1696c == 0x1696c, "Original PC 1696c")
  ASSERT(tsl9_spi_modify_mask_16974 == 0x16974, "Original PC 16974")
  ASSERT(tsl9_spi_modify_value_1697c == 0x1697c, "Original PC 1697c")
  ASSERT(tsl9_spi_modify_finish_16984 == 0x16984, "Original PC 16984")
}
