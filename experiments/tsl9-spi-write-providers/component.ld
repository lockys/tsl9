OUTPUT_ARCH(riscv)
SECTIONS {
  .spi_write : ALIGN(2) {
    KEEP(*(.text.tsl9_tagged_external_168de))
    KEEP(*(.text.tsl9_spi_write_guard1_168e6))
    KEEP(*(.text.tsl9_spi_write_select1_168f0))
    KEEP(*(.text.tsl9_spi_write_guard2_168fa))
    KEEP(*(.text.tsl9_spi_write_select2_168fe))
    KEEP(*(.text.tsl9_spi_write_command_16908))
    KEEP(*(.text.tsl9_spi_write_address_16910))
    KEEP(*(.text.tsl9_spi_write_test_1691a))
    KEEP(*(.text.tsl9_spi_write_finish_1691e))
    KEEP(*(.text.tsl9_spi_write_payload_16932))
    KEEP(*(.text.tsl9_tagged_external_1693e))
    KEEP(*(.text.tsl9_spi_modify_guard1_16942))
    KEEP(*(.text.tsl9_spi_modify_select1_16948))
    KEEP(*(.text.tsl9_spi_modify_guard2_16952))
    KEEP(*(.text.tsl9_spi_modify_select2_16956))
    KEEP(*(.text.tsl9_spi_modify_command_16960))
    KEEP(*(.text.tsl9_spi_modify_address_1696c))
    KEEP(*(.text.tsl9_spi_modify_mask_16974))
    KEEP(*(.text.tsl9_spi_modify_value_1697c))
    KEEP(*(.text.tsl9_spi_modify_finish_16984))
  }
  /DISCARD/ : { *(.comment) *(.note*) *(.riscv.attributes) }
  ASSERT(SIZEOF(.spi_write) == 182, "Two original write providers182B")
  ASSERT(tsl9_tagged_external_168de == 0, "Original region 168de")
  ASSERT(tsl9_spi_write_guard1_168e6 == 8, "Original region 168e6")
  ASSERT(tsl9_spi_write_select1_168f0 == 18, "Original region 168f0")
  ASSERT(tsl9_spi_write_guard2_168fa == 28, "Original region 168fa")
  ASSERT(tsl9_spi_write_select2_168fe == 32, "Original region 168fe")
  ASSERT(tsl9_spi_write_command_16908 == 42, "Original region 16908")
  ASSERT(tsl9_spi_write_address_16910 == 50, "Original region 16910")
  ASSERT(tsl9_spi_write_test_1691a == 60, "Original region 1691a")
  ASSERT(tsl9_spi_write_finish_1691e == 64, "Original region 1691e")
  ASSERT(tsl9_spi_write_payload_16932 == 84, "Original region 16932")
  ASSERT(tsl9_tagged_external_1693e == 96, "Original region 1693e")
  ASSERT(tsl9_spi_modify_guard1_16942 == 100, "Original region 16942")
  ASSERT(tsl9_spi_modify_select1_16948 == 106, "Original region 16948")
  ASSERT(tsl9_spi_modify_guard2_16952 == 116, "Original region 16952")
  ASSERT(tsl9_spi_modify_select2_16956 == 120, "Original region 16956")
  ASSERT(tsl9_spi_modify_command_16960 == 130, "Original region 16960")
  ASSERT(tsl9_spi_modify_address_1696c == 142, "Original region 1696c")
  ASSERT(tsl9_spi_modify_mask_16974 == 150, "Original region 16974")
  ASSERT(tsl9_spi_modify_value_1697c == 158, "Original region 1697c")
  ASSERT(tsl9_spi_modify_finish_16984 == 166, "Original region 16984")
}
