OUTPUT_ARCH(riscv)
SECTIONS {
  .channel_graph : ALIGN(2) {
    KEEP(*(.program_graph))
    KEEP(*(.text.tsl9_channel_external_81b0))
    KEEP(*(.text.tsl9_channel_clock_frame_81b6))
    KEEP(*(.text.tsl9_channel_clock_scale_81bc))
    KEEP(*(.text.tsl9_channel_external_128fe))
    KEEP(*(.text.tsl9_filter_input_frame_12904))
    KEEP(*(.text.tsl9_filter_input_fill_1290a))
    KEEP(*(.text.tsl9_filter_input_cap_12920))
    KEEP(*(.text.tsl9_filter_input_small_1292c))
    KEEP(*(.text.tsl9_filter_input_copy_12930))
    KEEP(*(.text.tsl9_filter_input_loop_init_1293c))
    KEEP(*(.text.tsl9_filter_input_loop_12946))
    KEEP(*(.text.tsl9_filter_input_next_1298a))
    KEEP(*(.text.tsl9_filter_input_finish_1298e))
    KEEP(*(.text.tsl9_queue_external_12abe))
    KEEP(*(.text.tsl9_channel_zero_12ac2))
    KEEP(*(.text.tsl9_channel_nonzero_12aca))
    KEEP(*(.text.tsl9_channel_external_16858))
    KEEP(*(.text.tsl9_channel_timer_args_1685a))
    KEEP(*(.text.tsl9_channel_timer_nonzero_16876))
    KEEP(*(.text.tsl9_channel_timer_zero_16888))
    KEEP(*(.text.tsl9_channel_external_169dc))
    KEEP(*(.text.tsl9_channel_mode_write_169e2))
    KEEP(*(.text.tsl9_channel_clock_start_169f8))
    KEEP(*(.text.tsl9_channel_poll_setup_169fc))
    KEEP(*(.text.tsl9_channel_poll_clock_16a00))
    KEEP(*(.text.tsl9_channel_timeout_16a0c))
    KEEP(*(.text.tsl9_channel_mode_return_16a0e))
    KEEP(*(.text.tsl9_channel_poll_read_16a1c))
    KEEP(*(.text.tsl9_channel_mode_done_16a2c))
    KEEP(*(.text.tsl9_register_write_entry_16a30))
    KEEP(*(.text.tsl9_register_write_body))
    KEEP(*(.text.tsl9_channel_external_16cc4))
    KEEP(*(.text.tsl9_setup_resident_16cd2))
    KEEP(*(.text.tsl9_setup_frame_16cd8))
    KEEP(*(.text.tsl9_setup_clear_16ce6))
    KEEP(*(.text.tsl9_setup_length_16cfa))
    KEEP(*(.text.tsl9_setup_clamp_16d04))
    KEEP(*(.text.tsl9_setup_copy_16d06))
    KEEP(*(.text.tsl9_setup_mode_16d12))
    KEEP(*(.text.tsl9_setup_write0_16d1c))
    KEEP(*(.text.tsl9_setup_write1_16d2a))
    KEEP(*(.text.tsl9_setup_loop_init_16d3e))
    KEEP(*(.text.tsl9_setup_loop_16d4c))
    KEEP(*(.text.tsl9_setup_test_16d82))
    KEEP(*(.text.tsl9_setup_normal_16d86))
    KEEP(*(.text.tsl9_setup_final_16d8e))
    KEEP(*(.text.tsl9_setup_return_16d96))
    KEEP(*(.text.tsl9_setup_early_16daa))
    KEEP(*(.text.tsl9_filter_program_18ba2))
    KEEP(*(.text.tsl9_filter_scale16_18bd4))
    KEEP(*(.text.tsl9_filter_fr2_18bfe))
    KEEP(*(.text.tsl9_filter_mode_18c04))
    KEEP(*(.text.tsl9_filter_mode_mask_18c12))
    KEEP(*(.text.tsl9_filter_mode_store_18c18))
    KEEP(*(.text.tsl9_filter_fifo_18c1c))
    KEEP(*(.text.tsl9_filter_fifo0_18c2a))
    KEEP(*(.text.tsl9_filter_activation_18c34))
    KEEP(*(.text.tsl9_filter_activate_18c3c))
    KEEP(*(.text.tsl9_filter_finish_18c4a))
    KEEP(*(.text.tsl9_filter_scale_test_18c5a))
    KEEP(*(.text.tsl9_filter_scale32_18c5e))
    KEEP(*(.text.tsl9_filter_mode_list_18c8a))
    KEEP(*(.text.tsl9_filter_fifo_test_18c92))
    KEEP(*(.text.tsl9_filter_fifo1_18c98))
  }
  ASSERT(SIZEOF(.channel_graph) == 3166, "Parent2250 plus source916 bytes")
  /DISCARD/ : { *(.comment) *(.note*) *(.riscv.attributes) }
}
