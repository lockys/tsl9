/* Genuine code, retained parent data and two true relative-table OBJECTs. */
SECTIONS {
 .boot_code 0 : SUBALIGN(1) {
  *(.boot_code)
  *(.text.tsl9_feature_mode_getter_829e)
  *(.text.tsl9_channel_external_128fe)
  *(.text.tsl9_filter_input_frame_12904)
  *(.text.tsl9_filter_input_fill_1290a)
  *(.text.tsl9_filter_input_cap_12920)
  *(.text.tsl9_filter_input_small_1292c)
  *(.text.tsl9_filter_input_copy_12930)
  *(.text.tsl9_filter_input_loop_init_1293c)
  *(.text.tsl9_filter_input_loop_12946)
  *(.text.tsl9_filter_input_next_1298a)
  *(.text.tsl9_filter_input_finish_1298e)
  *(.text.tsl9_queue_external_12abe)
  *(.text.tsl9_channel_zero_12ac2)
  *(.text.tsl9_channel_nonzero_12aca)
  *(.text.tsl9_queue_external_14d2e)
  *(.text.tsl9_feature_outer_14d3a)
  *(.text.tsl9_feature_outer_14d40)
  *(.text.tsl9_feature_outer_14d52)
  *(.text.tsl9_feature_mode1_14d5e)
  *(.text.tsl9_feature_tree_14d6a)
  *(.text.tsl9_feature_tree_14d6e)
  *(.text.tsl9_feature_tree_14d76)
  *(.text.tsl9_feature_tree_14d7a)
  *(.text.tsl9_feature_tree_14d82)
  *(.text.tsl9_feature_tree_14d86)
  *(.text.tsl9_feature_tree_14d8e)
  *(.text.tsl9_feature_tree_14d92)
  *(.text.tsl9_feature_tree_14d9a)
  *(.text.tsl9_feature_return_14da2)
  *(.text.tsl9_feature_tree_14daa)
  *(.text.tsl9_feature_tree_14db2)
  *(.text.tsl9_feature_tree_14dba)
  *(.text.tsl9_feature_tree_14dc2)
  *(.text.tsl9_feature_tree_14dce)
  *(.text.tsl9_feature_tree_14dd6)
  *(.text.tsl9_feature_tree_14dda)
  *(.text.tsl9_feature_tree_14de2)
  *(.text.tsl9_feature_tree_14dea)
  *(.text.tsl9_feature_tree_14df6)
  *(.text.tsl9_feature_tree_14dfe)
  *(.text.tsl9_feature_tree_14e06)
  *(.text.tsl9_feature_tree_14e0e)
  *(.text.tsl9_feature_tree_14e1a)
  *(.text.tsl9_feature_tree_14e22)
  *(.text.tsl9_feature_tree_14e26)
  *(.text.tsl9_feature_tree_14e2e)
  *(.text.tsl9_feature_tree_14e32)
  *(.text.tsl9_feature_tree_14e3a)
  *(.text.tsl9_feature_tree_14e42)
  *(.text.tsl9_feature_tree_14e4e)
  *(.text.tsl9_feature_tree_14e56)
  *(.text.tsl9_feature_tree_14e5e)
  *(.text.tsl9_feature_tree_14e66)
  *(.text.tsl9_feature_tree_14e70)
  *(.text.tsl9_feature_tree_14e76)
  *(.text.tsl9_feature_tree_14e84)
  *(.text.tsl9_feature_tree_14e8c)
  *(.text.tsl9_feature_tree_14e90)
  *(.text.tsl9_feature_tree_14e98)
  *(.text.tsl9_feature_tree_14ea0)
  *(.text.tsl9_feature_tree_14ea8)
  *(.text.tsl9_feature_tree_14eb4)
  *(.text.tsl9_feature_tree_14ebc)
  *(.text.tsl9_feature_tree_14ec4)
  *(.text.tsl9_feature_tree_14ecc)
  *(.text.tsl9_feature_tree_14ed8)
  *(.text.tsl9_feature_tree_14ee0)
  *(.text.tsl9_feature_tree_14ee4)
  *(.text.tsl9_feature_tree_14eec)
  *(.text.tsl9_feature_tree_14ef0)
  *(.text.tsl9_feature_tree_14ef8)
  *(.text.tsl9_feature_tree_14efc)
  *(.text.tsl9_feature_tree_14f04)
  *(.text.tsl9_feature_tree_14f0c)
  *(.text.tsl9_feature_tree_14f18)
  *(.text.tsl9_feature_tree_14f20)
  *(.text.tsl9_feature_tree_14f28)
  *(.text.tsl9_feature_tree_14f30)
  *(.text.tsl9_feature_tree_14f3a)
  *(.text.tsl9_feature_tree_14f40)
  *(.text.tsl9_feature_tree_14f46)
  *(.text.tsl9_feature_tree_14f4e)
  *(.text.tsl9_feature_tree_14f52)
  *(.text.tsl9_feature_tree_14f5a)
  *(.text.tsl9_feature_tree_14f62)
  *(.text.tsl9_feature_tree_14f6a)
  *(.text.tsl9_feature_tree_14f76)
  *(.text.tsl9_feature_tree_14f7e)
  *(.text.tsl9_feature_tree_14f86)
  *(.text.tsl9_feature_tree_14f8e)
  *(.text.tsl9_feature_tree_14f94)
  *(.text.tsl9_feature_tree_14fa0)
  *(.text.tsl9_feature_tree_14fa8)
  *(.text.tsl9_feature_tree_14fac)
  *(.text.tsl9_feature_tree_14fb4)
  *(.text.tsl9_feature_tree_14fb8)
  *(.text.tsl9_feature_tree_14fc0)
  *(.text.tsl9_feature_tree_14fc8)
  *(.text.tsl9_feature_tree_14fd4)
  *(.text.tsl9_feature_tree_14fdc)
  *(.text.tsl9_feature_tree_14fe4)
  *(.text.tsl9_feature_tree_14fec)
  *(.text.tsl9_feature_tree_14ff6)
  *(.text.tsl9_feature_tree_15002)
  *(.text.tsl9_feature_tree_1500a)
  *(.text.tsl9_feature_tree_1500e)
  *(.text.tsl9_feature_tree_15016)
  *(.text.tsl9_feature_tree_1501e)
  *(.text.tsl9_feature_tree_15026)
  *(.text.tsl9_feature_tree_15032)
  *(.text.tsl9_feature_tree_1503a)
  *(.text.tsl9_feature_tree_15042)
  *(.text.tsl9_feature_tree_1504a)
  *(.text.tsl9_feature_tree_15050)
  *(.text.tsl9_feature_handler_1505c)
  *(.text.tsl9_feature_handler_15068)
  *(.text.tsl9_feature_handler_15072)
  *(.text.tsl9_feature_handler_1507e)
  *(.text.tsl9_feature_handler_1508a)
  *(.text.tsl9_feature_handler_15096)
  *(.text.tsl9_feature_handler_1509a)
  *(.text.tsl9_feature_handler_150a6)
  *(.text.tsl9_feature_handler_150b2)
  *(.text.tsl9_feature_handler_150be)
  *(.text.tsl9_feature_handler_150c4)
  *(.text.tsl9_feature_handler_150d0)
  *(.text.tsl9_feature_handler_150dc)
  *(.text.tsl9_feature_handler_150e2)
  *(.text.tsl9_feature_handler_150ee)
  *(.text.tsl9_feature_handler_150fa)
  *(.text.tsl9_feature_handler_15106)
  *(.text.tsl9_feature_handler_15108)
  *(.text.tsl9_feature_handler_15114)
  *(.text.tsl9_feature_handler_1511a)
  *(.text.tsl9_feature_handler_15126)
  *(.text.tsl9_feature_handler_1512c)
  *(.text.tsl9_feature_handler_15138)
  *(.text.tsl9_feature_handler_1513c)
  *(.text.tsl9_feature_handler_15148)
  *(.text.tsl9_feature_handler_15154)
  *(.text.tsl9_feature_handler_15160)
  *(.text.tsl9_feature_handler_1516a)
  *(.text.tsl9_feature_handler_15176)
  *(.text.tsl9_feature_handler_15182)
  *(.text.tsl9_feature_handler_15190)
  *(.text.tsl9_feature_handler_15194)
  *(.text.tsl9_feature_handler_15198)
  *(.text.tsl9_feature_handler_151a4)
  *(.text.tsl9_feature_handler_151b0)
  *(.text.tsl9_feature_handler_151b6)
  *(.text.tsl9_feature_handler_151c0)
  *(.text.tsl9_feature_handler_151c6)
  *(.text.tsl9_feature_handler_151d2)
  *(.text.tsl9_feature_handler_151de)
  *(.text.tsl9_feature_handler_151e6)
  *(.text.tsl9_feature_handler_151ec)
  *(.text.tsl9_feature_handler_151f2)
  *(.text.tsl9_feature_handler_151fe)
  *(.text.tsl9_feature_handler_15202)
  *(.text.tsl9_feature_handler_15208)
  *(.text.tsl9_feature_handler_1520a)
  *(.text.tsl9_feature_handler_15210)
  *(.text.tsl9_feature_handler_1521c)
  *(.text.tsl9_feature_handler_15222)
  *(.text.tsl9_feature_handler_1522e)
  *(.text.tsl9_feature_handler_15238)
  *(.text.tsl9_feature_handler_15246)
  *(.text.tsl9_feature_handler_1524a)
  *(.text.tsl9_feature_handler_15250)
  *(.text.tsl9_feature_handler_1525c)
  *(.text.tsl9_feature_handler_15262)
  *(.text.tsl9_feature_handler_1526e)
  *(.text.tsl9_feature_handler_15278)
  *(.text.tsl9_feature_handler_1527e)
  *(.text.tsl9_feature_handler_1528a)
  *(.text.tsl9_feature_handler_15296)
  *(.text.tsl9_feature_handler_1529c)
  *(.text.tsl9_feature_handler_152a8)
  *(.text.tsl9_feature_handler_152ae)
  *(.text.tsl9_feature_handler_152ba)
  *(.text.tsl9_feature_handler_152c4)
  *(.text.tsl9_feature_handler_152d0)
  *(.text.tsl9_feature_handler_152dc)
  *(.text.tsl9_feature_handler_152e8)
  *(.text.tsl9_feature_handler_152f4)
  *(.text.tsl9_feature_handler_152fe)
  *(.text.tsl9_feature_handler_15304)
  *(.text.tsl9_feature_handler_1530a)
  *(.text.tsl9_feature_handler_15326)
  *(.text.tsl9_feature_handler_15338)
  *(.text.tsl9_feature_handler_15364)
  *(.text.tsl9_feature_handler_15366)
  *(.text.tsl9_feature_handler_1536c)
  *(.text.tsl9_feature_handler_15370)
  *(.text.tsl9_feature_handler_15376)
  *(.text.tsl9_feature_handler_1537a)
  *(.text.tsl9_feature_handler_1537e)
  *(.text.tsl9_feature_handler_15382)
  *(.text.tsl9_feature_handler_1538a)
  *(.text.tsl9_feature_handler_15390)
  *(.text.tsl9_feature_handler_15394)
  *(.text.tsl9_feature_handler_1539a)
  *(.text.tsl9_feature_handler_1539e)
  *(.text.tsl9_feature_handler_153a6)
  *(.text.tsl9_feature_handler_153ac)
  *(.text.tsl9_feature_handler_153b0)
  *(.text.tsl9_feature_handler_153b4)
  *(.text.tsl9_feature_outer_153ba)
  *(.text.tsl9_feature_outer_153ce)
  *(.text.tsl9_feature_outer_153da)
  *(.text.tsl9_feature_outer_153ee)
  *(.text.tsl9_feature_outer_153fa)
  *(.text.tsl9_feature_outer_15416)
  *(.text.tsl9_feature_outer_15422)
  *(.text.tsl9_feature_outer_1542e)
  *(.text.tsl9_feature_outer_1543a)
  *(.text.tsl9_feature_outer_15456)
  *(.text.tsl9_feature_outer_15462)
  *(.text.tsl9_feature_outer_1546e)
  *(.text.tsl9_feature_outer_1547a)
  *(.text.tsl9_feature_outer_1548e)
  *(.text.tsl9_feature_outer_1549a)
  *(.text.tsl9_feature_outer_1549e)
  *(.text.tsl9_channel_external_16858)
  *(.text.tsl9_channel_timer_args_1685a)
  *(.text.tsl9_channel_timer_nonzero_16876)
  *(.text.tsl9_channel_timer_zero_16888)
  *(.text.tsl9_channel_external_169dc)
  *(.text.tsl9_channel_mode_write_169e2)
  *(.text.tsl9_channel_clock_start_169f8)
  *(.text.tsl9_channel_poll_setup_169fc)
  *(.text.tsl9_channel_poll_clock_16a00)
  *(.text.tsl9_channel_timeout_16a0c)
  *(.text.tsl9_channel_mode_return_16a0e)
  *(.text.tsl9_channel_poll_read_16a1c)
  *(.text.tsl9_channel_mode_done_16a2c)
  *(.text.tsl9_channel_external_16cc4)
  *(.text.tsl9_setup_resident_16cd2)
  *(.text.tsl9_setup_frame_16cd8)
  *(.text.tsl9_setup_clear_16ce6)
  *(.text.tsl9_setup_length_16cfa)
  *(.text.tsl9_setup_clamp_16d04)
  *(.text.tsl9_setup_copy_16d06)
  *(.text.tsl9_setup_mode_16d12)
  *(.text.tsl9_setup_write0_16d1c)
  *(.text.tsl9_setup_write1_16d2a)
  *(.text.tsl9_setup_loop_init_16d3e)
  *(.text.tsl9_setup_loop_16d4c)
  *(.text.tsl9_setup_test_16d82)
  *(.text.tsl9_setup_normal_16d86)
  *(.text.tsl9_setup_final_16d8e)
  *(.text.tsl9_setup_return_16d96)
  *(.text.tsl9_setup_early_16daa)
  *(.text.tsl9_filter_program_18ba2)
  *(.text.tsl9_filter_scale16_18bd4)
  *(.text.tsl9_filter_fr2_18bfe)
  *(.text.tsl9_filter_mode_18c04)
  *(.text.tsl9_filter_mode_mask_18c12)
  *(.text.tsl9_filter_mode_store_18c18)
  *(.text.tsl9_filter_fifo_18c1c)
  *(.text.tsl9_filter_fifo0_18c2a)
  *(.text.tsl9_filter_activation_18c34)
  *(.text.tsl9_filter_activate_18c3c)
  *(.text.tsl9_filter_finish_18c4a)
  *(.text.tsl9_filter_scale_test_18c5a)
  *(.text.tsl9_filter_scale32_18c5e)
  *(.text.tsl9_filter_mode_list_18c8a)
  *(.text.tsl9_filter_fifo_test_18c92)
  *(.text.tsl9_filter_fifo1_18c98)
 }
 .initializer 0 : SUBALIGN(1) { *(.initializer) }
 .vectors 0 : SUBALIGN(1) { *(.vectors) }
 .feature_tables 0 : SUBALIGN(4) {
  *(.rodata.tsl9_feature_mode_table_1a6b8)
  *(.rodata.tsl9_feature_nested_table)
 }
}
