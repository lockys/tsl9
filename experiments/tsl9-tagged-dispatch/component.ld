OUTPUT_ARCH(riscv)
SECTIONS {
  .tagged_dispatch : ALIGN(2) {
    KEEP(*(.text.tsl9_dispatch_external_16b7c))
    KEEP(*(.text.tsl9_tagged_config_16b8c))
    KEEP(*(.text.tsl9_tagged_frame_16b9c))
    KEEP(*(.text.tsl9_tagged_length_16ba8))
    KEEP(*(.text.tsl9_tagged_header_16bb2))
    KEEP(*(.text.tsl9_tagged_payload_16bd2))
    KEEP(*(.text.tsl9_tagged_loop_setup_16bfa))
    KEEP(*(.text.tsl9_tagged_loop_16bfe))
    KEEP(*(.text.tsl9_tagged_send_16c14))
    KEEP(*(.text.tsl9_tagged_request_16c30))
    KEEP(*(.text.tsl9_tagged_status_16c3e))
    KEEP(*(.text.tsl9_tagged_finish_16c52))
    KEEP(*(.text.tsl9_tagged_busy_16c62))
    KEEP(*(.text.tsl9_tagged_invalid_16c6c))
    KEEP(*(.text.tsl9_tagged_early_16c6e))
  }
  /DISCARD/ : { *(.comment) *(.note*) *(.riscv.attributes) }
  ASSERT(SIZEOF(.tagged_dispatch) == 246, "Original246B tagged candidate")
  ASSERT(tsl9_dispatch_external_16b7c == 0, "Entry")
  ASSERT(tsl9_tagged_config_16b8c == 16, "Config")
  ASSERT(tsl9_tagged_frame_16b9c == 32, "Frame64")
  ASSERT(tsl9_tagged_length_16ba8 == 44, "Initial length")
  ASSERT(tsl9_tagged_header_16bb2 == 54, "Header")
  ASSERT(tsl9_tagged_payload_16bd2 == 86, "Payload")
  ASSERT(tsl9_tagged_loop_setup_16bfa == 126, "Loop setup")
  ASSERT(tsl9_tagged_loop_16bfe == 130, "Loop")
  ASSERT(tsl9_tagged_send_16c14 == 152, "Send")
  ASSERT(tsl9_tagged_request_16c30 == 180, "Request")
  ASSERT(tsl9_tagged_status_16c3e == 194, "Status")
  ASSERT(tsl9_tagged_finish_16c52 == 214, "Framed return")
  ASSERT(tsl9_tagged_busy_16c62 == 230, "Post-RET retry")
  ASSERT(tsl9_tagged_invalid_16c6c == 240, "Invalid tag")
  ASSERT(tsl9_tagged_early_16c6e == 242, "No-frame return")
}
