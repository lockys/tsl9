OUTPUT_ARCH(riscv)
SECTIONS
{
 .boot_code 0 : SUBALIGN(2)
 {
  *(.boot_code)
  *(.text.tsl9_callback_external_10032)
  *(.text.tsl9_feature_external_10044)
  *(.text.tsl9_state_10066)
  *(.text.tsl9_state_1007c)
  *(.text.tsl9_state_10088)
  *(.text.tsl9_state_get_1008a)
  *(.text.tsl9_feature_external_10096)
  *(.text.tsl9_state_100ba)
  *(.text.tsl9_state_100c6)
  *(.text.tsl9_state_get_100c8)
  *(.text.tsl9_feature_external_100d6)
  *(.text.tsl9_state_100e8)
  *(.text.tsl9_state_100f4)
  *(.text.tsl9_state_get_100f6)
  *(.text.tsl9_feature_external_10100)
  *(.text.tsl9_state_10126)
  *(.text.tsl9_state_1012e)
  *(.text.tsl9_state_get_10130)
  *(.text.tsl9_state_10140)
  *(.text.tsl9_state_10154)
  *(.text.tsl9_callback_guard_828c)
  *(.text.tsl9_callback_checksum_ed00)
  *(.text.tsl9_callback_checksum_ed14)
  *(.text.tsl9_callback_checksum_ed1c)
  *(.text.tsl9_callback_checksum_ed20)
  *(.text.tsl9_callback_checksum_ed24)
  *(.text.tsl9_callback_checksum_ed32)
  *(.text.tsl9_callback_predicate_1069e)
  *(.text.tsl9_callback_predicate_106a0)
  *(.text.tsl9_callback_predicate_106ac)
  *(.text.tsl9_feature_external_106e8)
  *(.text.tsl9_callback_count_106f0)
  *(.text.tsl9_callback_count_106f2)
  *(.text.tsl9_callback_count_10704)
  *(.text.tsl9_feature_external_1074c)
  *(.text.tsl9_callback_state_10758)
  *(.text.tsl9_callback_state_1075c)
  *(.text.tsl9_callback_state_10766)
  *(.text.tsl9_callback_state_1077e)
  *(.text.tsl9_callback_state_10780)
  *(.text.tsl9_callback_state_10794)
  *(.text.tsl9_callback_state_1079a)
  *(.text.tsl9_callback_state_107a0)
  *(.text.tsl9_callback_state_107a4)
  *(.text.tsl9_callback_state_107b8)
  *(.text.tsl9_callback_deferred_107c0)
  *(.text.tsl9_feature_external_1083c)
  *(.text.tsl9_callback_wrapper_10848)
  *(.text.tsl9_callback_wrapper_1084c)
  *(.text.tsl9_callback_wrapper_10852)
  *(.text.tsl9_callback_wrapper_10866)
  *(.text.tsl9_events_137c0)
  *(.text.tsl9_events_137cc)
  *(.text.tsl9_events_137d8)
  *(.text.tsl9_events_137de)
  *(.text.tsl9_events_137e8)
  *(.text.tsl9_events_137ec)
  *(.text.tsl9_events_137ee)
  *(.text.tsl9_events_137f2)
  *(.text.tsl9_events_137fa)
  *(.text.tsl9_events_13800)
  *(.text.tsl9_events_13806)
  *(.text.tsl9_events_1380c)
  *(.text.tsl9_events_1380e)
  *(.text.tsl9_events_13818)
  *(.text.tsl9_events_1381e)
  *(.text.tsl9_events_13826)
  *(.text.tsl9_events_1382e)
  *(.text.tsl9_events_13830)
  *(.text.tsl9_events_13836)
  *(.text.tsl9_events_1383c)
  *(.text.tsl9_events_1383e)
  *(.text.tsl9_events_13846)
  *(.text.tsl9_events_1384c)
  *(.text.tsl9_events_13852)
  *(.text.tsl9_events_13854)
  *(.text.tsl9_events_1385e)
  *(.text.tsl9_events_13864)
  *(.text.tsl9_events_13868)
  *(.text.tsl9_events_1386c)
  *(.text.tsl9_events_13874)
  *(.text.tsl9_events_1387c)
  *(.text.tsl9_events_1387e)
  *(.text.tsl9_events_13888)
  *(.text.tsl9_events_1388e)
  *(.text.tsl9_events_13890)
  *(.text.tsl9_events_13898)
  *(.text.tsl9_events_1389e)
  *(.text.tsl9_events_138a0)
  *(.text.tsl9_events_138a8)
  *(.text.tsl9_events_138ae)
  *(.text.tsl9_events_138bc)
  *(.text.tsl9_events_138be)
  *(.text.tsl9_events_138ce)
  *(.text.tsl9_events_138d4)
  *(.text.tsl9_events_138da)
  *(.text.tsl9_events_138dc)
  *(.text.tsl9_events_138e0)
  *(.text.tsl9_events_138e6)
  *(.text.tsl9_events_138ec)
  *(.text.tsl9_events_138ee)
  *(.text.tsl9_events_138f2)
  *(.text.tsl9_events_138f8)
  *(.text.tsl9_events_138fe)
  *(.text.tsl9_events_13900)
  *(.text.tsl9_events_13906)
  *(.text.tsl9_events_1390c)
  *(.text.tsl9_events_1390e)
  *(.text.tsl9_events_13910)
  *(.text.tsl9_events_13914)
  *(.text.tsl9_events_1391a)
  *(.text.tsl9_events_13920)
  *(.text.tsl9_events_13924)
  *(.text.tsl9_events_13928)
  *(.text.tsl9_events_1392c)
  *(.text.tsl9_events_13930)
  *(.text.tsl9_events_13936)
  *(.text.tsl9_events_1393e)
  *(.text.tsl9_events_13940)
  *(.text.tsl9_events_1394c)
  *(.text.tsl9_events_1394e)
  *(.text.tsl9_events_13954)
  *(.text.tsl9_events_1395c)
  *(.text.tsl9_events_1395e)
  *(.text.tsl9_events_13968)
  *(.text.tsl9_events_1396e)
  *(.text.tsl9_events_13970)
  *(.text.tsl9_events_1397e)
  *(.text.tsl9_events_13984)
  *(.text.tsl9_events_1398e)
  *(.text.tsl9_events_13996)
  *(.text.tsl9_events_1399c)
  *(.text.tsl9_events_139a4)
  *(.text.tsl9_events_139a6)
  *(.text.tsl9_events_139ae)
  *(.text.tsl9_events_139b4)
  *(.text.tsl9_events_139b8)
  *(.text.tsl9_events_139c0)
  *(.text.tsl9_events_139c8)
  *(.text.tsl9_events_139cc)
  *(.text.tsl9_events_139ce)
  *(.text.tsl9_events_139d0)
  *(.text.tsl9_events_139d6)
  *(.text.tsl9_events_139e0)
  *(.text.tsl9_events_139e4)
  *(.text.tsl9_events_139ea)
  *(.text.tsl9_events_139ee)
  *(.text.tsl9_events_139f6)
  *(.text.tsl9_events_139fe)
  *(.text.tsl9_events_13a06)
  *(.text.tsl9_events_13a0e)
  *(.text.tsl9_events_13a12)
  *(.text.tsl9_events_13a1a)
  *(.text.tsl9_events_13a26)
  *(.text.tsl9_events_13a2a)
  *(.text.tsl9_events_13a32)
  *(.text.tsl9_events_13a3a)
  *(.text.tsl9_events_13a3e)
  *(.text.tsl9_events_13a40)
  *(.text.tsl9_events_13a44)
  *(.text.tsl9_events_13a48)
  *(.text.tsl9_events_13a50)
  *(.text.tsl9_events_13a58)
  *(.text.tsl9_events_13a60)
  *(.text.tsl9_events_13a64)
  *(.text.tsl9_events_13a70)
  *(.text.tsl9_events_13a78)
  *(.text.tsl9_events_13a7e)
  *(.text.tsl9_events_13a86)
  *(.text.tsl9_events_13a8e)
  *(.text.tsl9_events_13a96)
  *(.text.tsl9_events_13a9e)
  *(.text.tsl9_events_13aa6)
  *(.text.tsl9_events_13aaa)
  *(.text.tsl9_events_13ab4)
  *(.text.tsl9_events_13abc)
  *(.text.tsl9_events_13ac2)
  *(.text.tsl9_events_13aca)
  *(.text.tsl9_events_13ad2)
  *(.text.tsl9_events_13ad6)
  *(.text.tsl9_events_13ae0)
  *(.text.tsl9_events_13ae8)
  *(.text.tsl9_events_13aec)
  *(.text.tsl9_events_13af4)
  *(.text.tsl9_events_13af8)
  *(.text.tsl9_events_13afe)
  *(.text.tsl9_events_13b02)
  *(.text.tsl9_events_13b08)
  *(.text.tsl9_events_13b10)
  *(.text.tsl9_events_13b18)
  *(.text.tsl9_events_13b22)
  *(.text.tsl9_events_13b2a)
  *(.text.tsl9_events_13b2c)
  *(.text.tsl9_events_13b34)
  *(.text.tsl9_events_13b38)
  *(.text.tsl9_events_13b46)
  *(.text.tsl9_events_13b4a)
  *(.text.tsl9_events_13b4c)
  *(.text.tsl9_events_13b60)
  *(.text.tsl9_events_13b62)
  *(.text.tsl9_events_13b6a)
  *(.text.tsl9_events_13b6c)
  *(.text.tsl9_events_13b72)
  *(.text.tsl9_events_13b74)
  *(.text.tsl9_events_13b78)
  *(.text.tsl9_events_13b84)
  *(.text.tsl9_events_13b98)
  *(.text.tsl9_events_13ba6)
  *(.text.tsl9_events_13bba)
  *(.text.tsl9_events_13bc2)
  *(.text.tsl9_events_13bc4)
  *(.text.tsl9_events_13bcc)
  *(.text.tsl9_events_13bce)
  *(.text.tsl9_feature_external_13bd2)
  *(.text.tsl9_events_13bdc)
  *(.text.tsl9_events_13c02)
  *(.text.tsl9_events_13c08)
  *(.text.tsl9_events_13c10)
  *(.text.tsl9_events_13c18)
  *(.text.tsl9_events_13c22)
  *(.text.tsl9_events_13c28)
  *(.text.tsl9_events_13c2a)
  *(.text.tsl9_events_13c32)
  *(.text.tsl9_events_13c36)
  *(.text.tsl9_events_13c48)
  *(.text.tsl9_events_13c4c)
  *(.text.tsl9_state_external_13c4e)
  *(.text.tsl9_events_13c66)
  *(.text.tsl9_events_13c70)
  *(.text.tsl9_events_13c7a)
  *(.text.tsl9_events_13c86)
  *(.text.tsl9_events_13c90)
  *(.text.tsl9_events_13c9a)
  *(.text.tsl9_events_13ca2)
  *(.text.tsl9_events_13ca6)
  *(.text.tsl9_events_13cb4)
  *(.text.tsl9_events_13cba)
  *(.text.tsl9_events_13cbc)
  *(.text.tsl9_events_13cc2)
  *(.text.tsl9_events_13cc4)
  *(.text.tsl9_events_13cd4)
  *(.text.tsl9_events_13cda)
  *(.text.tsl9_state_leaf_entry_81f8)
  *(.text.tsl9_state_leaf_entry_8202)
  *(.text.tsl9_state_leaf_entry_a968)
  *(.text.tsl9_state_leaf_entry_a976)
  *(.text.tsl9_state_leaf_block_a99a)
  *(.text.tsl9_state_leaf_block_a9a8)
  *(.text.tsl9_state_leaf_entry_a9bc)
  *(.text.tsl9_state_leaf_block_a9d8)
  *(.text.tsl9_state_leaf_block_a9dc)
  *(.text.tsl9_state_leaf_entry_ab68)
  *(.text.tsl9_state_leaf_entry_ab72)
  *(.text.tsl9_state_leaf_entry_b082)
  *(.text.tsl9_state_leaf_block_b08a)
  *(.text.tsl9_state_leaf_block_b08e)
  *(.text.tsl9_state_leaf_block_b092)
  *(.text.tsl9_state_leaf_block_b096)
  *(.text.tsl9_state_leaf_block_b0a6)
  *(.text.tsl9_state_leaf_block_b0a8)
  *(.text.tsl9_state_leaf_entry_b3da)
  *(.text.tsl9_state_leaf_entry_b3e4)
  *(.text.tsl9_state_leaf_entry_b3ee)
  *(.text.tsl9_state_leaf_entry_b3f8)
  *(.text.tsl9_state_leaf_entry_c462)
  *(.text.tsl9_state_leaf_entry_d048)
  *(.text.tsl9_state_leaf_entry_d052)
  *(.text.tsl9_state_leaf_entry_d190)
  *(.text.tsl9_state_leaf_entry_d322)
  *(.text.tsl9_state_leaf_entry_d468)
  *(.text.tsl9_state_leaf_entry_d472)
  *(.text.tsl9_state_leaf_entry_d4e0)
  *(.text.tsl9_state_leaf_entry_d4ea)
  *(.text.tsl9_state_leaf_entry_d754)
  *(.text.tsl9_state_leaf_entry_dee2)
  *(.text.tsl9_state_leaf_entry_e038)
  *(.text.tsl9_state_leaf_entry_e058)
  *(.text.tsl9_state_leaf_block_e076)
  *(.text.tsl9_state_leaf_block_e078)
  *(.text.tsl9_state_leaf_block_e08a)
  *(.text.tsl9_state_leaf_block_e08c)
  *(.text.tsl9_state_leaf_block_e09e)
  *(.text.tsl9_state_leaf_block_e0a0)
  *(.text.tsl9_state_leaf_entry_f65c)
  *(.text.tsl9_state_leaf_entry_f992)
  *(.text.tsl9_state_leaf_entry_10402)
  *(.text.tsl9_state_leaf_entry_10408)
 }
 .initializer 0 : { *(.initializer) }
 .vectors 0 : { *(.vectors) }
 .feature_tables 0 : SUBALIGN(4) { *(.feature_tables) }
 tsl9_events_external_10402 = tsl9_state_leaf_entry_10402;
 tsl9_events_external_10408 = tsl9_state_leaf_entry_10408;
 tsl9_events_external_81f8 = tsl9_state_leaf_entry_81f8;
 tsl9_events_external_a976 = tsl9_state_leaf_entry_a976;
 tsl9_events_external_a9bc = tsl9_state_leaf_entry_a9bc;
 tsl9_events_external_ab68 = tsl9_state_leaf_entry_ab68;
 tsl9_events_external_ab72 = tsl9_state_leaf_entry_ab72;
 tsl9_events_external_b082 = tsl9_state_leaf_entry_b082;
 tsl9_events_external_b3da = tsl9_state_leaf_entry_b3da;
 tsl9_events_external_b3e4 = tsl9_state_leaf_entry_b3e4;
 tsl9_events_external_b3ee = tsl9_state_leaf_entry_b3ee;
 tsl9_events_external_b3f8 = tsl9_state_leaf_entry_b3f8;
 tsl9_events_external_c462 = tsl9_state_leaf_entry_c462;
 tsl9_events_external_d048 = tsl9_state_leaf_entry_d048;
 tsl9_events_external_d052 = tsl9_state_leaf_entry_d052;
 tsl9_events_external_d190 = tsl9_state_leaf_entry_d190;
 tsl9_events_external_d322 = tsl9_state_leaf_entry_d322;
 tsl9_events_external_d468 = tsl9_state_leaf_entry_d468;
 tsl9_events_external_d472 = tsl9_state_leaf_entry_d472;
 tsl9_events_external_d4e0 = tsl9_state_leaf_entry_d4e0;
 tsl9_events_external_d4ea = tsl9_state_leaf_entry_d4ea;
 tsl9_events_external_d754 = tsl9_state_leaf_entry_d754;
 tsl9_events_external_dee2 = tsl9_state_leaf_entry_dee2;
 tsl9_events_external_e038 = tsl9_state_leaf_entry_e038;
 tsl9_events_external_e058 = tsl9_state_leaf_entry_e058;
 tsl9_events_external_f65c = tsl9_state_leaf_entry_f65c;
 tsl9_events_external_f992 = tsl9_state_leaf_entry_f992;
 tsl9_callback_external_9b36 = tsl9_queue_external_9b36;
 /DISCARD/ : { *(.comment) *(.riscv.attributes) *(.llvm_addrsig) }
}
