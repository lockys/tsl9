/* Exact original relative RF offsets;absolute placement remains unproved. */
SECTIONS {
 .rf_code 0 : SUBALIGN(1) {
  *(.text.tsl9_rf_completion_entry_173ee)
  *(.text.tsl9_rf_completion_block_17408)
  *(.text.tsl9_rf_completion_block_17428)
  *(.text.tsl9_rf_completion_block_1743a)
  *(.text.tsl9_rf_completion_entry_17442)
  *(.text.tsl9_rf_completion_block_1745a)
  *(.text.tsl9_rf_completion_block_17460)
  *(.text.tsl9_rf_callbacks_entry_17476)
  *(.text.tsl9_rf_callbacks_block_1748a)
  *(.text.tsl9_rf_callbacks_block_17492)
  *(.text.tsl9_rf_callbacks_block_17494)
  *(.text.tsl9_rf_callbacks_block_17498)
  *(.text.tsl9_rf_callbacks_block_1749c)
  *(.text.tsl9_rf_callbacks_block_174a6)
  *(.text.tsl9_rf_callbacks_block_174ac)
  *(.text.tsl9_rf_callbacks_block_174b6)
  *(.text.tsl9_rf_callbacks_block_174d4)
  *(.text.tsl9_rf_callbacks_block_174da)
  *(.text.tsl9_rf_callbacks_block_174e2)
  *(.text.tsl9_rf_callbacks_block_174e8)
  *(.text.tsl9_rf_callbacks_entry_174ee)
  *(.text.tsl9_rf_callbacks_block_174f4)
  *(.text.tsl9_rf_callbacks_block_174f8)
  *(.text.tsl9_rf_callbacks_block_17504)
  *(.text.tsl9_rf_callbacks_block_17508)
  *(.text.tsl9_rf_callbacks_block_1750a)
  *(.text.tsl9_rf_callbacks_block_17512)
  *(.text.tsl9_rf_callbacks_block_17522)
  *(.text.tsl9_rf_callbacks_block_17532)
  *(.text.tsl9_rf_callbacks_block_17538)
  *(.text.tsl9_resident_providers_entry_1753a)
  *(.text.tsl9_resident_providers_block_17546)
  *(.text.tsl9_resident_providers_block_175b0)
  *(.text.tsl9_resident_providers_block_175b8)
  *(.text.tsl9_resident_providers_block_175ca)
  *(.text.tsl9_resident_providers_block_175d8)
  *(.text.tsl9_resident_providers_block_175e4)
  *(.text.tsl9_resident_providers_entry_175e8)
  *(.text.tsl9_resident_providers_block_17608)
  *(.text.tsl9_resident_providers_block_17616)
  *(.text.tsl9_resident_providers_block_17626)
  *(.text.tsl9_resident_providers_block_1765c)
  *(.text.tsl9_event_consumer_entry_17666)
  *(.text.tsl9_event_consumer_block_1767e)
  *(.text.tsl9_event_consumer_block_17680)
  *(.text.tsl9_event_consumer_block_17686)
  *(.text.tsl9_event_consumer_block_17692)
  *(.text.tsl9_event_consumer_block_17698)
  *(.text.tsl9_event_consumer_entry_176a0)
  *(.text.tsl9_event_consumer_block_176c8)
  *(.text.tsl9_event_consumer_block_176ca)
  *(.text.tsl9_event_consumer_block_176de)
  *(.text.tsl9_event_consumer_block_176f2)
  *(.text.tsl9_event_consumer_entry_176f8)
  *(.text.tsl9_event_consumer_block_1770c)
  *(.text.tsl9_event_consumer_block_1771e)
  *(.text.tsl9_event_consumer_block_17744)
  *(.text.tsl9_event_consumer_block_17746)
  *(.text.tsl9_event_consumer_block_17764)
  *(.text.tsl9_event_consumer_block_17768)
  *(.text.tsl9_event_consumer_block_17776)
  *(.text.tsl9_event_consumer_block_17780)
  *(.text.tsl9_event_consumer_block_177a2)
  *(.text.tsl9_event_consumer_block_177a8)
  *(.text.tsl9_event_consumer_block_177b2)
  *(.text.tsl9_event_consumer_block_177c4)
  *(.text.tsl9_event_consumer_block_177cc)
  *(.text.tsl9_event_consumer_block_177dc)
  *(.text.tsl9_event_consumer_block_177e2)
  *(.text.tsl9_event_consumer_block_177e8)
  *(.text.tsl9_event_consumer_block_177ee)
  *(.text.tsl9_event_consumer_block_177f8)
  *(.text.tsl9_event_consumer_block_17806)
  *(.text.tsl9_event_consumer_block_17816)
  *(.text.tsl9_event_consumer_block_17826)
  *(.text.tsl9_event_consumer_block_17830)
  *(.text.tsl9_event_consumer_block_17832)
  *(.text.tsl9_record_queue_entry_1787c)
  *(.text.tsl9_record_queue_block_1789a)
  *(.text.tsl9_record_queue_block_178be)
  *(.text.tsl9_record_queue_block_178dc)
  *(.text.tsl9_record_queue_block_178de)
  *(.text.tsl9_record_queue_block_178ee)
  *(.text.tsl9_record_queue_entry_178f8)
  *(.text.tsl9_record_queue_block_1790a)
  *(.text.tsl9_record_queue_block_17942)
  *(.text.tsl9_record_queue_entry_17948)
  *(.text.tsl9_record_queue_block_1796c)
  *(.text.tsl9_record_queue_block_17972)
  *(.text.tsl9_record_queue_block_17982)
  *(.text.tsl9_record_queue_block_17988)
  *(.text.tsl9_record_control_entry_1798a)
  *(.text.tsl9_record_control_block_17992)
  *(.text.tsl9_record_control_block_17998)
  *(.text.tsl9_record_control_block_179b2)
  *(.text.tsl9_record_control_block_179c0)
  *(.text.tsl9_record_control_block_179ca)
  *(.text.tsl9_record_control_block_179ce)
  *(.text.tsl9_record_control_block_179d8)
  *(.text.tsl9_record_control_block_179de)
  *(.text.tsl9_record_control_block_179e4)
  *(.text.tsl9_record_control_block_179f8)
  *(.text.tsl9_record_control_block_179fa)
  tsl9_rf_callbacks_provider_173ee = tsl9_rf_completion_entry_173ee;
  tsl9_rf_callbacks_provider_17442 = tsl9_rf_completion_entry_17442;
  tsl9_event_consumer_provider_1753a = tsl9_resident_providers_entry_1753a;
  tsl9_record_queue_provider_17666 = tsl9_event_consumer_entry_17666;
  tsl9_record_control_provider_1787c = tsl9_record_queue_entry_1787c;
 }
}
