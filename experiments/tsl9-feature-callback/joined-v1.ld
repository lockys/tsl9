SECTIONS {
  .feature_graph : {
    KEEP(*(.feature_graph))
    KEEP(*(.text.tsl9_callback_guard_828c))
    KEEP(*(.text.tsl9_callback_checksum_ed00))
    KEEP(*(.text.tsl9_callback_checksum_ed14))
    KEEP(*(.text.tsl9_callback_checksum_ed1c))
    KEEP(*(.text.tsl9_callback_checksum_ed20))
    KEEP(*(.text.tsl9_callback_checksum_ed24))
    KEEP(*(.text.tsl9_callback_checksum_ed32))
    KEEP(*(.text.tsl9_callback_predicate_1069e))
    KEEP(*(.text.tsl9_callback_predicate_106a0))
    KEEP(*(.text.tsl9_callback_predicate_106ac))
    KEEP(*(.text.tsl9_feature_external_106e8))
    KEEP(*(.text.tsl9_callback_count_106f0))
    KEEP(*(.text.tsl9_callback_count_106f2))
    KEEP(*(.text.tsl9_callback_count_10704))
    KEEP(*(.text.tsl9_feature_external_1074c))
    KEEP(*(.text.tsl9_callback_state_10758))
    KEEP(*(.text.tsl9_callback_state_1075c))
    KEEP(*(.text.tsl9_callback_state_10766))
    KEEP(*(.text.tsl9_callback_state_1077e))
    KEEP(*(.text.tsl9_callback_state_10780))
    KEEP(*(.text.tsl9_callback_state_10794))
    KEEP(*(.text.tsl9_callback_state_1079a))
    KEEP(*(.text.tsl9_callback_state_107a0))
    KEEP(*(.text.tsl9_callback_state_107a4))
    KEEP(*(.text.tsl9_callback_state_107b8))
    KEEP(*(.text.tsl9_callback_deferred_107c0))
    KEEP(*(.text.tsl9_feature_external_1083c))
    KEEP(*(.text.tsl9_callback_wrapper_10848))
    KEEP(*(.text.tsl9_callback_wrapper_1084c))
    KEEP(*(.text.tsl9_callback_wrapper_10852))
    KEEP(*(.text.tsl9_callback_wrapper_10866))
  }
  .table_0 : { KEEP(*(.table_0)) }
  .table_1 : { KEEP(*(.table_1)) }
}
ASSERT(SIZEOF(.feature_graph) == 5402, "Exact parent plus callback code extent")
ASSERT(SIZEOF(.table_0) == 28, "Exact outer relative table extent")
ASSERT(SIZEOF(.table_1) == 32, "Exact nested relative table extent")
