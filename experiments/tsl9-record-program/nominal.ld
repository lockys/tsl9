OUTPUT_ARCH(riscv)
ENTRY(tsl9_queue_external_9454)
SECTIONS {
  .program 0x93AA : ALIGN(2) {
    KEEP(*(.text.tsl9_program_arm_93aa))
    KEEP(*(.text.tsl9_program_arm_body_93c0))
    KEEP(*(.text.tsl9_program_arm_return_93ec))
    KEEP(*(.text.tsl9_program_disarm_93ee))
    KEEP(*(.text.tsl9_program_allocate_9410))
    KEEP(*(.text.tsl9_program_old_pointer_941e))
    KEEP(*(.text.tsl9_program_free_9424))
    KEEP(*(.text.tsl9_program_cleanup_942c))
    KEEP(*(.text.tsl9_program_allocate_tail_943e))
    KEEP(*(.text.tsl9_queue_external_9454))
    KEEP(*(.text.tsl9_program_small_9464))
    KEEP(*(.text.tsl9_program_prepare_9472))
    KEEP(*(.text.tsl9_program_test_948e))
    KEEP(*(.text.tsl9_program_finish_9492))
    KEEP(*(.text.tsl9_program_restore_tail_949e))
    KEEP(*(.text.tsl9_program_fill_94a8))
    KEEP(*(.text.tsl9_program_large_94be))
    KEEP(*(.text.tsl9_program_special_94cc))
    KEEP(*(.text.tsl9_program_failure_94e4))
  }
  /DISCARD/ : { *(.comment) *(.note*) *(.riscv.attributes) }
  ASSERT(SIZEOF(.program) == 324, "Original program324B")
  ASSERT(tsl9_program_arm_93aa == 0x93aa, "Original region address")
  ASSERT(tsl9_program_arm_body_93c0 == 0x93c0, "Original region address")
  ASSERT(tsl9_program_arm_return_93ec == 0x93ec, "Original region address")
  ASSERT(tsl9_program_disarm_93ee == 0x93ee, "Original region address")
  ASSERT(tsl9_program_allocate_9410 == 0x9410, "Original region address")
  ASSERT(tsl9_program_old_pointer_941e == 0x941e, "Original region address")
  ASSERT(tsl9_program_free_9424 == 0x9424, "Original region address")
  ASSERT(tsl9_program_cleanup_942c == 0x942c, "Original region address")
  ASSERT(tsl9_program_allocate_tail_943e == 0x943e, "Original region address")
  ASSERT(tsl9_queue_external_9454 == 0x9454, "Original region address")
  ASSERT(tsl9_program_small_9464 == 0x9464, "Original region address")
  ASSERT(tsl9_program_prepare_9472 == 0x9472, "Original region address")
  ASSERT(tsl9_program_test_948e == 0x948e, "Original region address")
  ASSERT(tsl9_program_finish_9492 == 0x9492, "Original region address")
  ASSERT(tsl9_program_restore_tail_949e == 0x949e, "Original region address")
  ASSERT(tsl9_program_fill_94a8 == 0x94a8, "Original region address")
  ASSERT(tsl9_program_large_94be == 0x94be, "Original region address")
  ASSERT(tsl9_program_special_94cc == 0x94cc, "Original region address")
  ASSERT(tsl9_program_failure_94e4 == 0x94e4, "Original region address")
}
