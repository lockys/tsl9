OUTPUT_ARCH(riscv)
SECTIONS {
  .transport_dispatch : ALIGN(2) {
    KEEP(*(.dispatch))
    KEEP(*(.text.tsl9_filter_external_8a56))
    KEEP(*(.text.tsl9_transport_frame_8a5e))
    KEEP(*(.text.tsl9_transport_first_8a7a))
    KEEP(*(.text.tsl9_transport_first_result_8a90))
    KEEP(*(.text.tsl9_transport_second_8a96))
    KEEP(*(.text.tsl9_transport_second_result_8ab6))
    KEEP(*(.text.tsl9_transport_reject_8abe))
    KEEP(*(.text.tsl9_transport_select0_8acc))
    KEEP(*(.text.tsl9_transport_pack_8ace))
    KEEP(*(.text.tsl9_transport_test_8b0a))
    KEEP(*(.text.tsl9_transport_finish_8b14))
    KEEP(*(.text.tsl9_transport_copy_8b52))
    KEEP(*(.text.tsl9_transport_bare_return_8b6c))
  }
  /DISCARD/ : { *(.comment) *(.note*) *(.riscv.attributes) }
  ASSERT(tsl9_queue_entry_12c58 == 0, "Existing complete dispatch at diagnostic zero")
  ASSERT(tsl9_filter_external_8a56 == 526, "Genuine transport follows all526 dispatch bytes")
  ASSERT(tsl9_transport_frame_8a5e == 534, "Private transport frame")
  ASSERT(tsl9_transport_first_8a7a == 562, "First path")
  ASSERT(tsl9_transport_first_result_8a90 == 584, "First result")
  ASSERT(tsl9_transport_second_8a96 == 590, "Second path")
  ASSERT(tsl9_transport_second_result_8ab6 == 622, "Second result")
  ASSERT(tsl9_transport_reject_8abe == 630, "Rejection path")
  ASSERT(tsl9_transport_select0_8acc == 644, "Selector zero")
  ASSERT(tsl9_transport_pack_8ace == 646, "Transport packaging")
  ASSERT(tsl9_transport_test_8b0a == 706, "Then-live selector")
  ASSERT(tsl9_transport_finish_8b14 == 716, "Frame return")
  ASSERT(tsl9_transport_copy_8b52 == 778, "Retained post-RET copy")
  ASSERT(tsl9_transport_bare_return_8b6c == 804, "Bare return")
  ASSERT(SIZEOF(.transport_dispatch) == 806, "All526 plus280 genuine bytes retained")
}
