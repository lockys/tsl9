OUTPUT_ARCH(riscv)
SECTIONS
{
 .original_code_0001061c 0x1061c : SUBALIGN(2) { *(.text.tsl9_callback_flow_entry_1061c) }
 .original_code_0001070a 0x1070a : SUBALIGN(2) { *(.text.tsl9_callback_flow_entry_1070a) }
 .original_code_00010712 0x10712 : SUBALIGN(2) { *(.text.tsl9_callback_flow_block_10712) }
 .original_code_00010718 0x10718 : SUBALIGN(2) { *(.text.tsl9_callback_flow_block_10718) }
 .original_code_0001072c 0x1072c : SUBALIGN(2) { *(.text.tsl9_callback_flow_block_1072c) }
 .original_code_00010730 0x10730 : SUBALIGN(2) { *(.text.tsl9_callback_flow_block_10730) }
 .original_code_0001073c 0x1073c : SUBALIGN(2) { *(.text.tsl9_callback_flow_block_1073c) }
 .original_code_0001299e 0x1299e : SUBALIGN(2) { *(.text.tsl9_callback_flow_entry_1299e) }
 .original_code_000129b4 0x129b4 : SUBALIGN(2) { *(.text.tsl9_callback_flow_block_129b4) }
 .original_code_000129be 0x129be : SUBALIGN(2) { *(.text.tsl9_callback_flow_block_129be) }
 .original_code_000129c4 0x129c4 : SUBALIGN(2) { *(.text.tsl9_callback_flow_entry_129c4) }
 .original_code_000129d8 0x129d8 : SUBALIGN(2) { *(.text.tsl9_callback_flow_block_129d8) }
 .original_code_000129f6 0x129f6 : SUBALIGN(2) { *(.text.tsl9_callback_flow_block_129f6) }
 .original_code_000129fa 0x129fa : SUBALIGN(2) { *(.text.tsl9_callback_flow_block_129fa) }
 .original_code_00012aa0 0x12aa0 : SUBALIGN(2) { *(.text.tsl9_callback_flow_entry_12aa0) }
 .original_code_00012aaa 0x12aaa : SUBALIGN(2) { *(.text.tsl9_callback_flow_block_12aaa) }
 .original_code_00012aae 0x12aae : SUBALIGN(2) { *(.text.tsl9_callback_flow_block_12aae) }
 .original_code_00012ab6 0x12ab6 : SUBALIGN(2) { *(.text.tsl9_callback_flow_block_12ab6) }
 .original_code_0001333c 0x1333c : SUBALIGN(2) { *(.text.tsl9_callback_flow_entry_1333c) }
 .original_code_00013346 0x13346 : SUBALIGN(2) { *(.text.tsl9_callback_flow_entry_13346) }
 .original_code_00013362 0x13362 : SUBALIGN(2) { *(.text.tsl9_callback_flow_block_13362) }
 .original_code_00013382 0x13382 : SUBALIGN(2) { *(.text.tsl9_callback_flow_block_13382) }
 .original_code_000133a6 0x133a6 : SUBALIGN(2) { *(.text.tsl9_callback_flow_block_133a6) }
 .original_code_000133ac 0x133ac : SUBALIGN(2) { *(.text.tsl9_callback_flow_block_133ac) }
 .original_code_000133b4 0x133b4 : SUBALIGN(2) { *(.text.tsl9_callback_flow_block_133b4) }
 .original_code_000133c4 0x133c4 : SUBALIGN(2) { *(.text.tsl9_callback_flow_block_133c4) }
 .original_code_000133d4 0x133d4 : SUBALIGN(2) { *(.text.tsl9_callback_flow_block_133d4) }
 .original_code_000133e0 0x133e0 : SUBALIGN(2) { *(.text.tsl9_callback_flow_block_133e0) }
 .original_code_000133f0 0x133f0 : SUBALIGN(2) { *(.text.tsl9_callback_flow_block_133f0) }
 .original_code_000133f4 0x133f4 : SUBALIGN(2) { *(.text.tsl9_callback_flow_block_133f4) }
 .original_code_00013404 0x13404 : SUBALIGN(2) { *(.text.tsl9_callback_flow_block_13404) }
 .original_code_00013414 0x13414 : SUBALIGN(2) { *(.text.tsl9_callback_flow_block_13414) }
 .original_code_0001342c 0x1342c : SUBALIGN(2) { *(.text.tsl9_callback_flow_block_1342c) }
 .original_code_00013434 0x13434 : SUBALIGN(2) { *(.text.tsl9_callback_flow_block_13434) }
 .original_code_00013444 0x13444 : SUBALIGN(2) { *(.text.tsl9_callback_flow_block_13444) }
 .original_code_00013454 0x13454 : SUBALIGN(2) { *(.text.tsl9_callback_flow_block_13454) }
 .original_code_00013466 0x13466 : SUBALIGN(2) { *(.text.tsl9_callback_flow_block_13466) }
 .original_code_00013478 0x13478 : SUBALIGN(2) { *(.text.tsl9_callback_flow_block_13478) }
 .original_code_00013488 0x13488 : SUBALIGN(2) { *(.text.tsl9_callback_flow_block_13488) }
 .original_code_00013498 0x13498 : SUBALIGN(2) { *(.text.tsl9_callback_flow_block_13498) }
 .original_code_000134a8 0x134a8 : SUBALIGN(2) { *(.text.tsl9_callback_flow_block_134a8) }
 .original_code_000134b0 0x134b0 : SUBALIGN(2) { *(.text.tsl9_callback_flow_block_134b0) }
 .original_code_000134c0 0x134c0 : SUBALIGN(2) { *(.text.tsl9_callback_flow_block_134c0) }
 .original_code_000134d0 0x134d0 : SUBALIGN(2) { *(.text.tsl9_callback_flow_block_134d0) }
 .original_code_000134e0 0x134e0 : SUBALIGN(2) { *(.text.tsl9_callback_flow_block_134e0) }
 .original_code_000134f0 0x134f0 : SUBALIGN(2) { *(.text.tsl9_callback_flow_block_134f0) }
 .original_code_00013500 0x13500 : SUBALIGN(2) { *(.text.tsl9_callback_flow_block_13500) }
 .original_code_00013512 0x13512 : SUBALIGN(2) { *(.text.tsl9_callback_flow_block_13512) }
 .original_code_00013516 0x13516 : SUBALIGN(2) { *(.text.tsl9_callback_flow_block_13516) }
 .original_code_00013526 0x13526 : SUBALIGN(2) { *(.text.tsl9_callback_flow_block_13526) }
 .original_code_00013536 0x13536 : SUBALIGN(2) { *(.text.tsl9_callback_flow_block_13536) }
 .original_code_0001353e 0x1353e : SUBALIGN(2) { *(.text.tsl9_callback_flow_block_1353e) }
 .original_code_00013552 0x13552 : SUBALIGN(2) { *(.text.tsl9_callback_flow_block_13552) }
 .original_code_0001355c 0x1355c : SUBALIGN(2) { *(.text.tsl9_callback_flow_block_1355c) }
 .original_code_0001356e 0x1356e : SUBALIGN(2) { *(.text.tsl9_callback_flow_block_1356e) }
 .original_code_00013586 0x13586 : SUBALIGN(2) { *(.text.tsl9_callback_flow_block_13586) }
 .original_code_00013598 0x13598 : SUBALIGN(2) { *(.text.tsl9_callback_flow_block_13598) }
 .original_code_000135ac 0x135ac : SUBALIGN(2) { *(.text.tsl9_callback_flow_block_135ac) }
 .original_code_000135b0 0x135b0 : SUBALIGN(2) { *(.text.tsl9_callback_flow_block_135b0) }
 .original_code_000135c6 0x135c6 : SUBALIGN(2) { *(.text.tsl9_callback_flow_block_135c6) }
 .original_code_000135ca 0x135ca : SUBALIGN(2) { *(.text.tsl9_callback_flow_block_135ca) }
 .original_code_000135d8 0x135d8 : SUBALIGN(2) { *(.text.tsl9_callback_flow_block_135d8) }
 .original_code_000135e4 0x135e4 : SUBALIGN(2) { *(.text.tsl9_callback_flow_block_135e4) }
 .original_code_000135e6 0x135e6 : SUBALIGN(2) { *(.text.tsl9_callback_flow_entry_135e6) }
 .original_code_000135fe 0x135fe : SUBALIGN(2) { *(.text.tsl9_callback_flow_block_135fe) }
 .original_code_00013608 0x13608 : SUBALIGN(2) { *(.text.tsl9_callback_flow_block_13608) }
 .original_code_00013612 0x13612 : SUBALIGN(2) { *(.text.tsl9_callback_flow_block_13612) }
 .original_code_00013620 0x13620 : SUBALIGN(2) { *(.text.tsl9_callback_flow_block_13620) }
 .original_code_0001362a 0x1362a : SUBALIGN(2) { *(.text.tsl9_callback_flow_block_1362a) }
 .original_code_00013634 0x13634 : SUBALIGN(2) { *(.text.tsl9_callback_flow_block_13634) }
 .original_code_00013656 0x13656 : SUBALIGN(2) { *(.text.tsl9_callback_flow_block_13656) }
 .original_code_0001365e 0x1365e : SUBALIGN(2) { *(.text.tsl9_callback_flow_block_1365e) }
 .original_code_00016dd4 0x16dd4 : SUBALIGN(2) { *(.text.tsl9_callback_flow_entry_16dd4) }
 .original_code_00016de2 0x16de2 : SUBALIGN(2) { *(.text.tsl9_callback_flow_block_16de2) }
 .original_code_00016dea 0x16dea : SUBALIGN(2) { *(.text.tsl9_callback_flow_block_16dea) }
 .original_code_00016dec 0x16dec : SUBALIGN(2) { *(.text.tsl9_callback_flow_block_16dec) }
 .original_code_00016df6 0x16df6 : SUBALIGN(2) { *(.text.tsl9_callback_flow_block_16df6) }
 .original_code_00016dfc 0x16dfc : SUBALIGN(2) { *(.text.tsl9_callback_flow_block_16dfc) }
 .original_code_00016e02 0x16e02 : SUBALIGN(2) { *(.text.tsl9_callback_flow_block_16e02) }
 .original_data_00019ca8 0x19ca8 : SUBALIGN(4) { *(.rodata.tsl9_callback_flow_constants_19ca8) }
 /DISCARD/ : { *(.comment) *(.riscv.attributes) *(.llvm_addrsig) }
}
