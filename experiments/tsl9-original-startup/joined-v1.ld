/* Unresolved partial link only. No RAM, stack, ROM or final-VMA assumptions. */
SECTIONS
{
  .boot_code 0 : SUBALIGN(1)
  {
    *(.text.tsl9_boot_entry_8000)
    *(.text.tsl9_boot_8004)
    *(.text.tsl9_boot_18630)
    *(.text.tsl9_boot_18632)
    *(.text.tsl9_boot_18634)
    *(.text.tsl9_boot_18636)
    *(.text.tsl9_boot_18638)
    *(.text.tsl9_boot_1863a)
    *(.text.tsl9_boot_1863c)
    *(.text.tsl9_boot_1863e)
    *(.text.tsl9_boot_18640)
    *(.text.tsl9_boot_18642)
    *(.text.tsl9_boot_18644)
    *(.text.tsl9_boot_18646)
    *(.text.tsl9_boot_18648)
    *(.text.tsl9_boot_1864a)
    *(.text.tsl9_boot_1864c)
    *(.text.tsl9_boot_1864e)
    *(.text.tsl9_boot_18650)
    *(.text.tsl9_boot_18652)
    *(.text.tsl9_boot_18654)
    *(.text.tsl9_boot_18656)
    *(.text.tsl9_boot_18658)
    *(.text.tsl9_boot_1865a)
    *(.text.tsl9_boot_1865c)
    *(.text.tsl9_boot_1865e)
    *(.text.tsl9_boot_18660)
    *(.text.tsl9_boot_18662)
    *(.text.tsl9_boot_18664)
    *(.text.tsl9_boot_18666)
    *(.text.tsl9_boot_18668)
    *(.text.tsl9_boot_1866a)
    *(.text.tsl9_boot_1866c)
    *(.text.tsl9_boot_1866e)
    *(.text.tsl9_boot_18670)
    *(.text.tsl9_boot_18672)
    *(.text.tsl9_boot_18674)
    *(.text.tsl9_boot_18676)
    *(.text.tsl9_boot_18678)
    *(.text.tsl9_boot_1867a)
    *(.text.tsl9_boot_1867c)
    *(.text.tsl9_boot_1867e)
    *(.text.tsl9_boot_18680)
    *(.text.tsl9_boot_18682)
    *(.text.tsl9_boot_18684)
    *(.text.tsl9_boot_18686)
    *(.text.tsl9_boot_18688)
    *(.text.tsl9_boot_1868a)
    *(.text.tsl9_boot_1868c)
    *(.text.tsl9_boot_1868e)
    *(.text.tsl9_boot_18690)
    *(.text.tsl9_boot_18692)
    *(.text.tsl9_boot_18694)
    *(.text.tsl9_boot_18696)
    *(.text.tsl9_boot_18698)
    *(.text.tsl9_boot_1869a)
    *(.text.tsl9_boot_1869c)
    *(.text.tsl9_boot_1869e)
    *(.text.tsl9_boot_186a0)
    *(.text.tsl9_boot_186a2)
    *(.text.tsl9_boot_186a4)
    *(.text.tsl9_boot_186a6)
    *(.text.tsl9_boot_186a8)
    *(.text.tsl9_reset_original_186aa)
    *(.text.tsl9_boot_186ba)
    *(.text.tsl9_boot_186c2)
    *(.text.tsl9_boot_186ce)
    *(.text.tsl9_boot_186d6)
    *(.text.tsl9_boot_186de)
    *(.text.tsl9_boot_186e2)
    *(.text.tsl9_boot_186ee)
    *(.text.tsl9_boot_186f8)
    *(.text.tsl9_boot_18724)
    *(.text.tsl9_boot_18734)
    *(.text.tsl9_boot_18738)
    *(.text.tsl9_boot_1873c)
    *(.text.tsl9_boot_1873e)
    *(.text.tsl9_boot_18746)
    *(.text.tsl9_clock_original_1874a)
    *(.text.tsl9_boot_18754)
    *(.text.tsl9_boot_18756)
    *(.text.tsl9_boot_18790)
    *(.text.tsl9_boot_18794)
    *(.text.tsl9_boot_187a2)
    *(.text.tsl9_boot_187a6)
    *(.text.tsl9_boot_187aa)
    *(.text.tsl9_boot_187ac)
    *(.text.tsl9_boot_187b2)
    *(.text.tsl9_boot_187b8)
    *(.text.tsl9_boot_187c6)
    *(.text.tsl9_boot_187c8)
    *(.text.tsl9_boot_187ca)
    *(.text.tsl9_boot_187cc)
    *(.text.tsl9_boot_187d2)
    *(.text.tsl9_boot_18806)
    *(.text.tsl9_boot_18810)
    *(.text.tsl9_boot_18824)
    *(.text.tsl9_boot_1882c)
    *(.text.tsl9_boot_18830)
  }
  .initializer 0 : SUBALIGN(1)
  {
    *(.rodata.tsl9_reset_initializer)
    tsl9_boot_initializer_1ab60 = tsl9_runtime_reset_initializer;
  }
}

