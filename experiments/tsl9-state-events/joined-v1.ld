SECTIONS {
  .feature_graph : {
    KEEP(*(.feature_graph))
    KEEP(*(.text.tsl9_events_137c0))
    KEEP(*(.text.tsl9_events_137cc))
    KEEP(*(.text.tsl9_events_137d8))
    KEEP(*(.text.tsl9_events_137de))
    KEEP(*(.text.tsl9_events_137e8))
    KEEP(*(.text.tsl9_events_137ec))
    KEEP(*(.text.tsl9_events_137ee))
    KEEP(*(.text.tsl9_events_137f2))
    KEEP(*(.text.tsl9_events_137fa))
    KEEP(*(.text.tsl9_events_13800))
    KEEP(*(.text.tsl9_events_13806))
    KEEP(*(.text.tsl9_events_1380c))
    KEEP(*(.text.tsl9_events_1380e))
    KEEP(*(.text.tsl9_events_13818))
    KEEP(*(.text.tsl9_events_1381e))
    KEEP(*(.text.tsl9_events_13826))
    KEEP(*(.text.tsl9_events_1382e))
    KEEP(*(.text.tsl9_events_13830))
    KEEP(*(.text.tsl9_events_13836))
    KEEP(*(.text.tsl9_events_1383c))
    KEEP(*(.text.tsl9_events_1383e))
    KEEP(*(.text.tsl9_events_13846))
    KEEP(*(.text.tsl9_events_1384c))
    KEEP(*(.text.tsl9_events_13852))
    KEEP(*(.text.tsl9_events_13854))
    KEEP(*(.text.tsl9_events_1385e))
    KEEP(*(.text.tsl9_events_13864))
    KEEP(*(.text.tsl9_events_13868))
    KEEP(*(.text.tsl9_events_1386c))
    KEEP(*(.text.tsl9_events_13874))
    KEEP(*(.text.tsl9_events_1387c))
    KEEP(*(.text.tsl9_events_1387e))
    KEEP(*(.text.tsl9_events_13888))
    KEEP(*(.text.tsl9_events_1388e))
    KEEP(*(.text.tsl9_events_13890))
    KEEP(*(.text.tsl9_events_13898))
    KEEP(*(.text.tsl9_events_1389e))
    KEEP(*(.text.tsl9_events_138a0))
    KEEP(*(.text.tsl9_events_138a8))
    KEEP(*(.text.tsl9_events_138ae))
    KEEP(*(.text.tsl9_events_138bc))
    KEEP(*(.text.tsl9_events_138be))
    KEEP(*(.text.tsl9_events_138ce))
    KEEP(*(.text.tsl9_events_138d4))
    KEEP(*(.text.tsl9_events_138da))
    KEEP(*(.text.tsl9_events_138dc))
    KEEP(*(.text.tsl9_events_138e0))
    KEEP(*(.text.tsl9_events_138e6))
    KEEP(*(.text.tsl9_events_138ec))
    KEEP(*(.text.tsl9_events_138ee))
    KEEP(*(.text.tsl9_events_138f2))
    KEEP(*(.text.tsl9_events_138f8))
    KEEP(*(.text.tsl9_events_138fe))
    KEEP(*(.text.tsl9_events_13900))
    KEEP(*(.text.tsl9_events_13906))
    KEEP(*(.text.tsl9_events_1390c))
    KEEP(*(.text.tsl9_events_1390e))
    KEEP(*(.text.tsl9_events_13910))
    KEEP(*(.text.tsl9_events_13914))
    KEEP(*(.text.tsl9_events_1391a))
    KEEP(*(.text.tsl9_events_13920))
    KEEP(*(.text.tsl9_events_13924))
    KEEP(*(.text.tsl9_events_13928))
    KEEP(*(.text.tsl9_events_1392c))
    KEEP(*(.text.tsl9_events_13930))
    KEEP(*(.text.tsl9_events_13936))
    KEEP(*(.text.tsl9_events_1393e))
    KEEP(*(.text.tsl9_events_13940))
    KEEP(*(.text.tsl9_events_1394c))
    KEEP(*(.text.tsl9_events_1394e))
    KEEP(*(.text.tsl9_events_13954))
    KEEP(*(.text.tsl9_events_1395c))
    KEEP(*(.text.tsl9_events_1395e))
    KEEP(*(.text.tsl9_events_13968))
    KEEP(*(.text.tsl9_events_1396e))
    KEEP(*(.text.tsl9_events_13970))
    KEEP(*(.text.tsl9_events_1397e))
    KEEP(*(.text.tsl9_events_13984))
    KEEP(*(.text.tsl9_events_1398e))
    KEEP(*(.text.tsl9_events_13996))
    KEEP(*(.text.tsl9_events_1399c))
    KEEP(*(.text.tsl9_events_139a4))
    KEEP(*(.text.tsl9_events_139a6))
    KEEP(*(.text.tsl9_events_139ae))
    KEEP(*(.text.tsl9_events_139b4))
    KEEP(*(.text.tsl9_events_139b8))
    KEEP(*(.text.tsl9_events_139c0))
    KEEP(*(.text.tsl9_events_139c8))
    KEEP(*(.text.tsl9_events_139cc))
    KEEP(*(.text.tsl9_events_139ce))
    KEEP(*(.text.tsl9_events_139d0))
    KEEP(*(.text.tsl9_events_139d6))
    KEEP(*(.text.tsl9_events_139e0))
    KEEP(*(.text.tsl9_events_139e4))
    KEEP(*(.text.tsl9_events_139ea))
    KEEP(*(.text.tsl9_events_139ee))
    KEEP(*(.text.tsl9_events_139f6))
    KEEP(*(.text.tsl9_events_139fe))
    KEEP(*(.text.tsl9_events_13a06))
    KEEP(*(.text.tsl9_events_13a0e))
    KEEP(*(.text.tsl9_events_13a12))
    KEEP(*(.text.tsl9_events_13a1a))
    KEEP(*(.text.tsl9_events_13a26))
    KEEP(*(.text.tsl9_events_13a2a))
    KEEP(*(.text.tsl9_events_13a32))
    KEEP(*(.text.tsl9_events_13a3a))
    KEEP(*(.text.tsl9_events_13a3e))
    KEEP(*(.text.tsl9_events_13a40))
    KEEP(*(.text.tsl9_events_13a44))
    KEEP(*(.text.tsl9_events_13a48))
    KEEP(*(.text.tsl9_events_13a50))
    KEEP(*(.text.tsl9_events_13a58))
    KEEP(*(.text.tsl9_events_13a60))
    KEEP(*(.text.tsl9_events_13a64))
    KEEP(*(.text.tsl9_events_13a70))
    KEEP(*(.text.tsl9_events_13a78))
    KEEP(*(.text.tsl9_events_13a7e))
    KEEP(*(.text.tsl9_events_13a86))
    KEEP(*(.text.tsl9_events_13a8e))
    KEEP(*(.text.tsl9_events_13a96))
    KEEP(*(.text.tsl9_events_13a9e))
    KEEP(*(.text.tsl9_events_13aa6))
    KEEP(*(.text.tsl9_events_13aaa))
    KEEP(*(.text.tsl9_events_13ab4))
    KEEP(*(.text.tsl9_events_13abc))
    KEEP(*(.text.tsl9_events_13ac2))
    KEEP(*(.text.tsl9_events_13aca))
    KEEP(*(.text.tsl9_events_13ad2))
    KEEP(*(.text.tsl9_events_13ad6))
    KEEP(*(.text.tsl9_events_13ae0))
    KEEP(*(.text.tsl9_events_13ae8))
    KEEP(*(.text.tsl9_events_13aec))
    KEEP(*(.text.tsl9_events_13af4))
    KEEP(*(.text.tsl9_events_13af8))
    KEEP(*(.text.tsl9_events_13afe))
    KEEP(*(.text.tsl9_events_13b02))
    KEEP(*(.text.tsl9_events_13b08))
    KEEP(*(.text.tsl9_events_13b10))
    KEEP(*(.text.tsl9_events_13b18))
    KEEP(*(.text.tsl9_events_13b22))
    KEEP(*(.text.tsl9_events_13b2a))
    KEEP(*(.text.tsl9_events_13b2c))
    KEEP(*(.text.tsl9_events_13b34))
    KEEP(*(.text.tsl9_events_13b38))
    KEEP(*(.text.tsl9_events_13b46))
    KEEP(*(.text.tsl9_events_13b4a))
    KEEP(*(.text.tsl9_events_13b4c))
    KEEP(*(.text.tsl9_events_13b60))
    KEEP(*(.text.tsl9_events_13b62))
    KEEP(*(.text.tsl9_events_13b6a))
    KEEP(*(.text.tsl9_events_13b6c))
    KEEP(*(.text.tsl9_events_13b72))
    KEEP(*(.text.tsl9_events_13b74))
    KEEP(*(.text.tsl9_events_13b78))
    KEEP(*(.text.tsl9_events_13b84))
    KEEP(*(.text.tsl9_events_13b98))
    KEEP(*(.text.tsl9_events_13ba6))
    KEEP(*(.text.tsl9_events_13bba))
    KEEP(*(.text.tsl9_events_13bc2))
    KEEP(*(.text.tsl9_events_13bc4))
    KEEP(*(.text.tsl9_events_13bcc))
    KEEP(*(.text.tsl9_events_13bce))
    KEEP(*(.text.tsl9_feature_external_13bd2))
    KEEP(*(.text.tsl9_events_13bdc))
    KEEP(*(.text.tsl9_events_13c02))
    KEEP(*(.text.tsl9_events_13c08))
    KEEP(*(.text.tsl9_events_13c10))
    KEEP(*(.text.tsl9_events_13c18))
    KEEP(*(.text.tsl9_events_13c22))
    KEEP(*(.text.tsl9_events_13c28))
    KEEP(*(.text.tsl9_events_13c2a))
    KEEP(*(.text.tsl9_events_13c32))
    KEEP(*(.text.tsl9_events_13c36))
    KEEP(*(.text.tsl9_events_13c48))
    KEEP(*(.text.tsl9_events_13c4c))
    KEEP(*(.text.tsl9_state_external_13c4e))
    KEEP(*(.text.tsl9_events_13c66))
    KEEP(*(.text.tsl9_events_13c70))
    KEEP(*(.text.tsl9_events_13c7a))
    KEEP(*(.text.tsl9_events_13c86))
    KEEP(*(.text.tsl9_events_13c90))
    KEEP(*(.text.tsl9_events_13c9a))
    KEEP(*(.text.tsl9_events_13ca2))
    KEEP(*(.text.tsl9_events_13ca6))
    KEEP(*(.text.tsl9_events_13cb4))
    KEEP(*(.text.tsl9_events_13cba))
    KEEP(*(.text.tsl9_events_13cbc))
    KEEP(*(.text.tsl9_events_13cc2))
    KEEP(*(.text.tsl9_events_13cc4))
    KEEP(*(.text.tsl9_events_13cd4))
    KEEP(*(.text.tsl9_events_13cda))
  }
  .table_0 : { KEEP(*(.table_0)) }
  .table_1 : { KEEP(*(.table_1)) }
}
ASSERT(SIZEOF(.feature_graph) == 7346, "Exact parent plus state-events extent")
ASSERT(SIZEOF(.table_0) == 28, "Exact original outer relative table")
ASSERT(SIZEOF(.table_1) == 32, "Exact original nested relative table")
