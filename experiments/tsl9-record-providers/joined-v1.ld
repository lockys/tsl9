/* Genuine selected C/C++ regions, sorted by original PC within this addition. */
SECTIONS {
 .boot_code 0 : SUBALIGN(1) {
  *(.boot_code)
  *(.provider_status_code)
  *(.text.tsl9_dispatch_external_821e)
  *(.text.tsl9_tagged_external_8520)
  *(.text.tsl9_fill_alignment_8528)
  *(.text.tsl9_fill_pattern_guard_852e)
  *(.text.tsl9_fill_word_setup_8530)
  *(.text.tsl9_fill_words_8538)
  *(.text.tsl9_fill_tail_guard_8546)
  *(.text.tsl9_fill_word_return_8548)
  *(.text.tsl9_fill_tail_dispatch_854a)
  *(.text.tsl9_fill_bytes_855a)
  *(.text.tsl9_fill_byte_return_8596)
  *(.text.tsl9_fill_pattern_8598)
  *(.text.tsl9_fill_align_dispatch_85aa)
  *(.text.tsl9_fill_align_resume_85ba)
  *(.text.tsl9_spi_transfer_entry_16896)
  *(.text.tsl9_spi_tx_poll_1689e)
  *(.text.tsl9_spi_tx_ready_168a6)
  *(.text.tsl9_spi_rx_poll_168b6)
  *(.text.tsl9_spi_rx_done_168be)
  *(.text.tsl9_spi_tx_wait_168c8)
  *(.text.tsl9_spi_timeout_168d0)
  *(.text.tsl9_spi_rx_wait_168d4)
  *(.text.tsl9_tagged_external_168de)
  *(.text.tsl9_spi_write_guard1_168e6)
  *(.text.tsl9_spi_write_select1_168f0)
  *(.text.tsl9_spi_write_guard2_168fa)
  *(.text.tsl9_spi_write_select2_168fe)
  *(.text.tsl9_spi_write_command_16908)
  *(.text.tsl9_spi_write_address_16910)
  *(.text.tsl9_spi_write_test_1691a)
  *(.text.tsl9_spi_write_finish_1691e)
  *(.text.tsl9_spi_write_payload_16932)
  *(.text.tsl9_tagged_external_1693e)
  *(.text.tsl9_spi_modify_guard1_16942)
  *(.text.tsl9_spi_modify_select1_16948)
  *(.text.tsl9_spi_modify_guard2_16952)
  *(.text.tsl9_spi_modify_select2_16956)
  *(.text.tsl9_spi_modify_command_16960)
  *(.text.tsl9_spi_modify_address_1696c)
  *(.text.tsl9_spi_modify_mask_16974)
  *(.text.tsl9_spi_modify_value_1697c)
  *(.text.tsl9_spi_modify_finish_16984)
  *(.text.tsl9_register_read_entry_16994)
  *(.text.tsl9_register_read_body)
  *(.text.tsl9_dispatch_external_16b7c)
  *(.text.tsl9_tagged_config_16b8c)
  *(.text.tsl9_tagged_frame_16b9c)
  *(.text.tsl9_tagged_length_16ba8)
  *(.text.tsl9_tagged_header_16bb2)
  *(.text.tsl9_tagged_payload_16bd2)
  *(.text.tsl9_tagged_loop_setup_16bfa)
  *(.text.tsl9_tagged_loop_16bfe)
  *(.text.tsl9_tagged_send_16c14)
  *(.text.tsl9_tagged_request_16c30)
  *(.text.tsl9_tagged_status_16c3e)
  *(.text.tsl9_tagged_finish_16c52)
  *(.text.tsl9_tagged_busy_16c62)
  *(.text.tsl9_tagged_invalid_16c6c)
  *(.text.tsl9_tagged_early_16c6e)
  *(.text.tsl9_dispatch_external_18ca4)
  *(.text.tsl9_peripheral_selected_18cc6)
  *(.text.tsl9_peripheral_metadata_18cec)
  *(.text.tsl9_peripheral_finish_18d5a)
  *(.text.tsl9_peripheral_select0_18d5e)
  *(.text.tsl9_peripheral_select1_18d62)
  *(.text.tsl9_peripheral_alternate_18d66)
  tsl9_queue_external_81aa = tsl9_queue_status_81aa;
 }
 .initializer 0 : SUBALIGN(1) { *(.initializer) }
 .vectors 0 : SUBALIGN(1) { *(.vectors) }
}
