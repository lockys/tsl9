OUTPUT_ARCH(riscv)
ENTRY(tsl9_dispatch_external_16b7c)
SECTIONS {
  .fill 0x8520 : ALIGN(2) {
    KEEP(*(.text.tsl9_tagged_external_8520))
    KEEP(*(.text.tsl9_fill_alignment_8528))
    KEEP(*(.text.tsl9_fill_pattern_guard_852e))
    KEEP(*(.text.tsl9_fill_word_setup_8530))
    KEEP(*(.text.tsl9_fill_words_8538))
    KEEP(*(.text.tsl9_fill_tail_guard_8546))
    KEEP(*(.text.tsl9_fill_word_return_8548))
    KEEP(*(.text.tsl9_fill_tail_dispatch_854a))
    KEEP(*(.text.tsl9_fill_bytes_855a))
    KEEP(*(.text.tsl9_fill_byte_return_8596))
    KEEP(*(.text.tsl9_fill_pattern_8598))
    KEEP(*(.text.tsl9_fill_align_dispatch_85aa))
    KEEP(*(.text.tsl9_fill_align_resume_85ba))
  }
  .transport 0x16896 : ALIGN(2) {
    KEEP(*(.text.tsl9_spi_transfer_entry_16896))
    KEEP(*(.text.tsl9_spi_tx_poll_1689e))
    KEEP(*(.text.tsl9_spi_tx_ready_168a6))
    KEEP(*(.text.tsl9_spi_rx_poll_168b6))
    KEEP(*(.text.tsl9_spi_rx_done_168be))
    KEEP(*(.text.tsl9_spi_tx_wait_168c8))
    KEEP(*(.text.tsl9_spi_timeout_168d0))
    KEEP(*(.text.tsl9_spi_rx_wait_168d4))
    KEEP(*(.text.tsl9_tagged_external_168de))
    KEEP(*(.text.tsl9_spi_write_guard1_168e6))
    KEEP(*(.text.tsl9_spi_write_select1_168f0))
    KEEP(*(.text.tsl9_spi_write_guard2_168fa))
    KEEP(*(.text.tsl9_spi_write_select2_168fe))
    KEEP(*(.text.tsl9_spi_write_command_16908))
    KEEP(*(.text.tsl9_spi_write_address_16910))
    KEEP(*(.text.tsl9_spi_write_test_1691a))
    KEEP(*(.text.tsl9_spi_write_finish_1691e))
    KEEP(*(.text.tsl9_spi_write_payload_16932))
    KEEP(*(.text.tsl9_tagged_external_1693e))
    KEEP(*(.text.tsl9_spi_modify_guard1_16942))
    KEEP(*(.text.tsl9_spi_modify_select1_16948))
    KEEP(*(.text.tsl9_spi_modify_guard2_16952))
    KEEP(*(.text.tsl9_spi_modify_select2_16956))
    KEEP(*(.text.tsl9_spi_modify_command_16960))
    KEEP(*(.text.tsl9_spi_modify_address_1696c))
    KEEP(*(.text.tsl9_spi_modify_mask_16974))
    KEEP(*(.text.tsl9_spi_modify_value_1697c))
    KEEP(*(.text.tsl9_spi_modify_finish_16984))
    KEEP(*(.text.tsl9_register_read_entry_16994))
    KEEP(*(.text.tsl9_register_read_body))
  }
  .tagged 0x16b7c : ALIGN(2) {
    KEEP(*(.text.tsl9_dispatch_external_16b7c))
    KEEP(*(.text.tsl9_tagged_config_16b8c))
    KEEP(*(.text.tsl9_tagged_frame_16b9c))
    KEEP(*(.text.tsl9_tagged_length_16ba8))
    KEEP(*(.text.tsl9_tagged_header_16bb2))
    KEEP(*(.text.tsl9_tagged_payload_16bd2))
    KEEP(*(.text.tsl9_tagged_loop_setup_16bfa))
    KEEP(*(.text.tsl9_tagged_loop_16bfe))
    KEEP(*(.text.tsl9_tagged_send_16c14))
    KEEP(*(.text.tsl9_tagged_request_16c30))
    KEEP(*(.text.tsl9_tagged_status_16c3e))
    KEEP(*(.text.tsl9_tagged_finish_16c52))
    KEEP(*(.text.tsl9_tagged_busy_16c62))
    KEEP(*(.text.tsl9_tagged_invalid_16c6c))
    KEEP(*(.text.tsl9_tagged_early_16c6e))
  }
  /DISCARD/ : { *(.comment) *(.note*) *(.riscv.attributes) }
  ASSERT(SIZEOF(.fill) == 168, "Original fill extent")
  ASSERT(SIZEOF(.transport) == 326, "SPI plus two write providers plus read")
  ASSERT(SIZEOF(.tagged) == 246, "Original tagged extent")
  ASSERT(tsl9_tagged_external_8520 == 0x8520, "Exact original tsl9_tagged_external_8520")
  ASSERT(tsl9_fill_alignment_8528 == 0x8528, "Exact original tsl9_fill_alignment_8528")
  ASSERT(tsl9_fill_pattern_guard_852e == 0x852e, "Exact original tsl9_fill_pattern_guard_852e")
  ASSERT(tsl9_fill_word_setup_8530 == 0x8530, "Exact original tsl9_fill_word_setup_8530")
  ASSERT(tsl9_fill_words_8538 == 0x8538, "Exact original tsl9_fill_words_8538")
  ASSERT(tsl9_fill_tail_guard_8546 == 0x8546, "Exact original tsl9_fill_tail_guard_8546")
  ASSERT(tsl9_fill_word_return_8548 == 0x8548, "Exact original tsl9_fill_word_return_8548")
  ASSERT(tsl9_fill_tail_dispatch_854a == 0x854a, "Exact original tsl9_fill_tail_dispatch_854a")
  ASSERT(tsl9_fill_bytes_855a == 0x855a, "Exact original tsl9_fill_bytes_855a")
  ASSERT(tsl9_fill_byte_return_8596 == 0x8596, "Exact original tsl9_fill_byte_return_8596")
  ASSERT(tsl9_fill_pattern_8598 == 0x8598, "Exact original tsl9_fill_pattern_8598")
  ASSERT(tsl9_fill_align_dispatch_85aa == 0x85aa, "Exact original tsl9_fill_align_dispatch_85aa")
  ASSERT(tsl9_fill_align_resume_85ba == 0x85ba, "Exact original tsl9_fill_align_resume_85ba")
  ASSERT(tsl9_spi_transfer_entry_16896 == 0x16896, "Exact original tsl9_spi_transfer_entry_16896")
  ASSERT(tsl9_spi_tx_poll_1689e == 0x1689e, "Exact original tsl9_spi_tx_poll_1689e")
  ASSERT(tsl9_spi_tx_ready_168a6 == 0x168a6, "Exact original tsl9_spi_tx_ready_168a6")
  ASSERT(tsl9_spi_rx_poll_168b6 == 0x168b6, "Exact original tsl9_spi_rx_poll_168b6")
  ASSERT(tsl9_spi_rx_done_168be == 0x168be, "Exact original tsl9_spi_rx_done_168be")
  ASSERT(tsl9_spi_tx_wait_168c8 == 0x168c8, "Exact original tsl9_spi_tx_wait_168c8")
  ASSERT(tsl9_spi_timeout_168d0 == 0x168d0, "Exact original tsl9_spi_timeout_168d0")
  ASSERT(tsl9_spi_rx_wait_168d4 == 0x168d4, "Exact original tsl9_spi_rx_wait_168d4")
  ASSERT(tsl9_tagged_external_168de == 0x168de, "Exact original tsl9_tagged_external_168de")
  ASSERT(tsl9_spi_write_guard1_168e6 == 0x168e6, "Exact original tsl9_spi_write_guard1_168e6")
  ASSERT(tsl9_spi_write_select1_168f0 == 0x168f0, "Exact original tsl9_spi_write_select1_168f0")
  ASSERT(tsl9_spi_write_guard2_168fa == 0x168fa, "Exact original tsl9_spi_write_guard2_168fa")
  ASSERT(tsl9_spi_write_select2_168fe == 0x168fe, "Exact original tsl9_spi_write_select2_168fe")
  ASSERT(tsl9_spi_write_command_16908 == 0x16908, "Exact original tsl9_spi_write_command_16908")
  ASSERT(tsl9_spi_write_address_16910 == 0x16910, "Exact original tsl9_spi_write_address_16910")
  ASSERT(tsl9_spi_write_test_1691a == 0x1691a, "Exact original tsl9_spi_write_test_1691a")
  ASSERT(tsl9_spi_write_finish_1691e == 0x1691e, "Exact original tsl9_spi_write_finish_1691e")
  ASSERT(tsl9_spi_write_payload_16932 == 0x16932, "Exact original tsl9_spi_write_payload_16932")
  ASSERT(tsl9_tagged_external_1693e == 0x1693e, "Exact original tsl9_tagged_external_1693e")
  ASSERT(tsl9_spi_modify_guard1_16942 == 0x16942, "Exact original tsl9_spi_modify_guard1_16942")
  ASSERT(tsl9_spi_modify_select1_16948 == 0x16948, "Exact original tsl9_spi_modify_select1_16948")
  ASSERT(tsl9_spi_modify_guard2_16952 == 0x16952, "Exact original tsl9_spi_modify_guard2_16952")
  ASSERT(tsl9_spi_modify_select2_16956 == 0x16956, "Exact original tsl9_spi_modify_select2_16956")
  ASSERT(tsl9_spi_modify_command_16960 == 0x16960, "Exact original tsl9_spi_modify_command_16960")
  ASSERT(tsl9_spi_modify_address_1696c == 0x1696c, "Exact original tsl9_spi_modify_address_1696c")
  ASSERT(tsl9_spi_modify_mask_16974 == 0x16974, "Exact original tsl9_spi_modify_mask_16974")
  ASSERT(tsl9_spi_modify_value_1697c == 0x1697c, "Exact original tsl9_spi_modify_value_1697c")
  ASSERT(tsl9_spi_modify_finish_16984 == 0x16984, "Exact original tsl9_spi_modify_finish_16984")
  ASSERT(tsl9_register_read_entry_16994 == 0x16994, "Exact original tsl9_register_read_entry_16994")
  ASSERT(tsl9_register_read_body == 0x16998, "Exact original tsl9_register_read_body")
  ASSERT(tsl9_dispatch_external_16b7c == 0x16b7c, "Exact original tsl9_dispatch_external_16b7c")
  ASSERT(tsl9_tagged_config_16b8c == 0x16b8c, "Exact original tsl9_tagged_config_16b8c")
  ASSERT(tsl9_tagged_frame_16b9c == 0x16b9c, "Exact original tsl9_tagged_frame_16b9c")
  ASSERT(tsl9_tagged_length_16ba8 == 0x16ba8, "Exact original tsl9_tagged_length_16ba8")
  ASSERT(tsl9_tagged_header_16bb2 == 0x16bb2, "Exact original tsl9_tagged_header_16bb2")
  ASSERT(tsl9_tagged_payload_16bd2 == 0x16bd2, "Exact original tsl9_tagged_payload_16bd2")
  ASSERT(tsl9_tagged_loop_setup_16bfa == 0x16bfa, "Exact original tsl9_tagged_loop_setup_16bfa")
  ASSERT(tsl9_tagged_loop_16bfe == 0x16bfe, "Exact original tsl9_tagged_loop_16bfe")
  ASSERT(tsl9_tagged_send_16c14 == 0x16c14, "Exact original tsl9_tagged_send_16c14")
  ASSERT(tsl9_tagged_request_16c30 == 0x16c30, "Exact original tsl9_tagged_request_16c30")
  ASSERT(tsl9_tagged_status_16c3e == 0x16c3e, "Exact original tsl9_tagged_status_16c3e")
  ASSERT(tsl9_tagged_finish_16c52 == 0x16c52, "Exact original tsl9_tagged_finish_16c52")
  ASSERT(tsl9_tagged_busy_16c62 == 0x16c62, "Exact original tsl9_tagged_busy_16c62")
  ASSERT(tsl9_tagged_invalid_16c6c == 0x16c6c, "Exact original tsl9_tagged_invalid_16c6c")
  ASSERT(tsl9_tagged_early_16c6e == 0x16c6e, "Exact original tsl9_tagged_early_16c6e")
}
