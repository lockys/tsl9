OUTPUT_ARCH(riscv)
SECTIONS {
  .feature_graph : ALIGN(2) {
    KEEP(*(.channel_graph))
    KEEP(*(.text.tsl9_feature_mode_getter_829e))
    KEEP(*(.text.tsl9_queue_external_14d2e))
    KEEP(*(.text.tsl9_feature_outer_14d3a))
    KEEP(*(.text.tsl9_feature_outer_14d40))
    KEEP(*(.text.tsl9_feature_outer_14d52))
    KEEP(*(.text.tsl9_feature_mode1_14d5e))
    KEEP(*(.text.tsl9_feature_tree_14d6a))
    KEEP(*(.text.tsl9_feature_tree_14d6e))
    KEEP(*(.text.tsl9_feature_tree_14d76))
    KEEP(*(.text.tsl9_feature_tree_14d7a))
    KEEP(*(.text.tsl9_feature_tree_14d82))
    KEEP(*(.text.tsl9_feature_tree_14d86))
    KEEP(*(.text.tsl9_feature_tree_14d8e))
    KEEP(*(.text.tsl9_feature_tree_14d92))
    KEEP(*(.text.tsl9_feature_tree_14d9a))
    KEEP(*(.text.tsl9_feature_return_14da2))
    KEEP(*(.text.tsl9_feature_tree_14daa))
    KEEP(*(.text.tsl9_feature_tree_14db2))
    KEEP(*(.text.tsl9_feature_tree_14dba))
    KEEP(*(.text.tsl9_feature_tree_14dc2))
    KEEP(*(.text.tsl9_feature_tree_14dce))
    KEEP(*(.text.tsl9_feature_tree_14dd6))
    KEEP(*(.text.tsl9_feature_tree_14dda))
    KEEP(*(.text.tsl9_feature_tree_14de2))
    KEEP(*(.text.tsl9_feature_tree_14dea))
    KEEP(*(.text.tsl9_feature_tree_14df6))
    KEEP(*(.text.tsl9_feature_tree_14dfe))
    KEEP(*(.text.tsl9_feature_tree_14e06))
    KEEP(*(.text.tsl9_feature_tree_14e0e))
    KEEP(*(.text.tsl9_feature_tree_14e1a))
    KEEP(*(.text.tsl9_feature_tree_14e22))
    KEEP(*(.text.tsl9_feature_tree_14e26))
    KEEP(*(.text.tsl9_feature_tree_14e2e))
    KEEP(*(.text.tsl9_feature_tree_14e32))
    KEEP(*(.text.tsl9_feature_tree_14e3a))
    KEEP(*(.text.tsl9_feature_tree_14e42))
    KEEP(*(.text.tsl9_feature_tree_14e4e))
    KEEP(*(.text.tsl9_feature_tree_14e56))
    KEEP(*(.text.tsl9_feature_tree_14e5e))
    KEEP(*(.text.tsl9_feature_tree_14e66))
    KEEP(*(.text.tsl9_feature_tree_14e70))
    KEEP(*(.text.tsl9_feature_tree_14e76))
    KEEP(*(.text.tsl9_feature_tree_14e84))
    KEEP(*(.text.tsl9_feature_tree_14e8c))
    KEEP(*(.text.tsl9_feature_tree_14e90))
    KEEP(*(.text.tsl9_feature_tree_14e98))
    KEEP(*(.text.tsl9_feature_tree_14ea0))
    KEEP(*(.text.tsl9_feature_tree_14ea8))
    KEEP(*(.text.tsl9_feature_tree_14eb4))
    KEEP(*(.text.tsl9_feature_tree_14ebc))
    KEEP(*(.text.tsl9_feature_tree_14ec4))
    KEEP(*(.text.tsl9_feature_tree_14ecc))
    KEEP(*(.text.tsl9_feature_tree_14ed8))
    KEEP(*(.text.tsl9_feature_tree_14ee0))
    KEEP(*(.text.tsl9_feature_tree_14ee4))
    KEEP(*(.text.tsl9_feature_tree_14eec))
    KEEP(*(.text.tsl9_feature_tree_14ef0))
    KEEP(*(.text.tsl9_feature_tree_14ef8))
    KEEP(*(.text.tsl9_feature_tree_14efc))
    KEEP(*(.text.tsl9_feature_tree_14f04))
    KEEP(*(.text.tsl9_feature_tree_14f0c))
    KEEP(*(.text.tsl9_feature_tree_14f18))
    KEEP(*(.text.tsl9_feature_tree_14f20))
    KEEP(*(.text.tsl9_feature_tree_14f28))
    KEEP(*(.text.tsl9_feature_tree_14f30))
    KEEP(*(.text.tsl9_feature_tree_14f3a))
    KEEP(*(.text.tsl9_feature_tree_14f40))
    KEEP(*(.text.tsl9_feature_tree_14f46))
    KEEP(*(.text.tsl9_feature_tree_14f4e))
    KEEP(*(.text.tsl9_feature_tree_14f52))
    KEEP(*(.text.tsl9_feature_tree_14f5a))
    KEEP(*(.text.tsl9_feature_tree_14f62))
    KEEP(*(.text.tsl9_feature_tree_14f6a))
    KEEP(*(.text.tsl9_feature_tree_14f76))
    KEEP(*(.text.tsl9_feature_tree_14f7e))
    KEEP(*(.text.tsl9_feature_tree_14f86))
    KEEP(*(.text.tsl9_feature_tree_14f8e))
    KEEP(*(.text.tsl9_feature_tree_14f94))
    KEEP(*(.text.tsl9_feature_tree_14fa0))
    KEEP(*(.text.tsl9_feature_tree_14fa8))
    KEEP(*(.text.tsl9_feature_tree_14fac))
    KEEP(*(.text.tsl9_feature_tree_14fb4))
    KEEP(*(.text.tsl9_feature_tree_14fb8))
    KEEP(*(.text.tsl9_feature_tree_14fc0))
    KEEP(*(.text.tsl9_feature_tree_14fc8))
    KEEP(*(.text.tsl9_feature_tree_14fd4))
    KEEP(*(.text.tsl9_feature_tree_14fdc))
    KEEP(*(.text.tsl9_feature_tree_14fe4))
    KEEP(*(.text.tsl9_feature_tree_14fec))
    KEEP(*(.text.tsl9_feature_tree_14ff6))
    KEEP(*(.text.tsl9_feature_tree_15002))
    KEEP(*(.text.tsl9_feature_tree_1500a))
    KEEP(*(.text.tsl9_feature_tree_1500e))
    KEEP(*(.text.tsl9_feature_tree_15016))
    KEEP(*(.text.tsl9_feature_tree_1501e))
    KEEP(*(.text.tsl9_feature_tree_15026))
    KEEP(*(.text.tsl9_feature_tree_15032))
    KEEP(*(.text.tsl9_feature_tree_1503a))
    KEEP(*(.text.tsl9_feature_tree_15042))
    KEEP(*(.text.tsl9_feature_tree_1504a))
    KEEP(*(.text.tsl9_feature_tree_15050))
    KEEP(*(.text.tsl9_feature_handler_1505c))
    KEEP(*(.text.tsl9_feature_handler_15068))
    KEEP(*(.text.tsl9_feature_handler_15072))
    KEEP(*(.text.tsl9_feature_handler_1507e))
    KEEP(*(.text.tsl9_feature_handler_1508a))
    KEEP(*(.text.tsl9_feature_handler_15096))
    KEEP(*(.text.tsl9_feature_handler_1509a))
    KEEP(*(.text.tsl9_feature_handler_150a6))
    KEEP(*(.text.tsl9_feature_handler_150b2))
    KEEP(*(.text.tsl9_feature_handler_150be))
    KEEP(*(.text.tsl9_feature_handler_150c4))
    KEEP(*(.text.tsl9_feature_handler_150d0))
    KEEP(*(.text.tsl9_feature_handler_150dc))
    KEEP(*(.text.tsl9_feature_handler_150e2))
    KEEP(*(.text.tsl9_feature_handler_150ee))
    KEEP(*(.text.tsl9_feature_handler_150fa))
    KEEP(*(.text.tsl9_feature_handler_15106))
    KEEP(*(.text.tsl9_feature_handler_15108))
    KEEP(*(.text.tsl9_feature_handler_15114))
    KEEP(*(.text.tsl9_feature_handler_1511a))
    KEEP(*(.text.tsl9_feature_handler_15126))
    KEEP(*(.text.tsl9_feature_handler_1512c))
    KEEP(*(.text.tsl9_feature_handler_15138))
    KEEP(*(.text.tsl9_feature_handler_1513c))
    KEEP(*(.text.tsl9_feature_handler_15148))
    KEEP(*(.text.tsl9_feature_handler_15154))
    KEEP(*(.text.tsl9_feature_handler_15160))
    KEEP(*(.text.tsl9_feature_handler_1516a))
    KEEP(*(.text.tsl9_feature_handler_15176))
    KEEP(*(.text.tsl9_feature_handler_15182))
    KEEP(*(.text.tsl9_feature_handler_15190))
    KEEP(*(.text.tsl9_feature_handler_15194))
    KEEP(*(.text.tsl9_feature_handler_15198))
    KEEP(*(.text.tsl9_feature_handler_151a4))
    KEEP(*(.text.tsl9_feature_handler_151b0))
    KEEP(*(.text.tsl9_feature_handler_151b6))
    KEEP(*(.text.tsl9_feature_handler_151c0))
    KEEP(*(.text.tsl9_feature_handler_151c6))
    KEEP(*(.text.tsl9_feature_handler_151d2))
    KEEP(*(.text.tsl9_feature_handler_151de))
    KEEP(*(.text.tsl9_feature_handler_151e6))
    KEEP(*(.text.tsl9_feature_handler_151ec))
    KEEP(*(.text.tsl9_feature_handler_151f2))
    KEEP(*(.text.tsl9_feature_handler_151fe))
    KEEP(*(.text.tsl9_feature_handler_15202))
    KEEP(*(.text.tsl9_feature_handler_15208))
    KEEP(*(.text.tsl9_feature_handler_1520a))
    KEEP(*(.text.tsl9_feature_handler_15210))
    KEEP(*(.text.tsl9_feature_handler_1521c))
    KEEP(*(.text.tsl9_feature_handler_15222))
    KEEP(*(.text.tsl9_feature_handler_1522e))
    KEEP(*(.text.tsl9_feature_handler_15238))
    KEEP(*(.text.tsl9_feature_handler_15246))
    KEEP(*(.text.tsl9_feature_handler_1524a))
    KEEP(*(.text.tsl9_feature_handler_15250))
    KEEP(*(.text.tsl9_feature_handler_1525c))
    KEEP(*(.text.tsl9_feature_handler_15262))
    KEEP(*(.text.tsl9_feature_handler_1526e))
    KEEP(*(.text.tsl9_feature_handler_15278))
    KEEP(*(.text.tsl9_feature_handler_1527e))
    KEEP(*(.text.tsl9_feature_handler_1528a))
    KEEP(*(.text.tsl9_feature_handler_15296))
    KEEP(*(.text.tsl9_feature_handler_1529c))
    KEEP(*(.text.tsl9_feature_handler_152a8))
    KEEP(*(.text.tsl9_feature_handler_152ae))
    KEEP(*(.text.tsl9_feature_handler_152ba))
    KEEP(*(.text.tsl9_feature_handler_152c4))
    KEEP(*(.text.tsl9_feature_handler_152d0))
    KEEP(*(.text.tsl9_feature_handler_152dc))
    KEEP(*(.text.tsl9_feature_handler_152e8))
    KEEP(*(.text.tsl9_feature_handler_152f4))
    KEEP(*(.text.tsl9_feature_handler_152fe))
    KEEP(*(.text.tsl9_feature_handler_15304))
    KEEP(*(.text.tsl9_feature_handler_1530a))
    KEEP(*(.text.tsl9_feature_handler_15326))
    KEEP(*(.text.tsl9_feature_handler_15338))
    KEEP(*(.text.tsl9_feature_handler_15364))
    KEEP(*(.text.tsl9_feature_handler_15366))
    KEEP(*(.text.tsl9_feature_handler_1536c))
    KEEP(*(.text.tsl9_feature_handler_15370))
    KEEP(*(.text.tsl9_feature_handler_15376))
    KEEP(*(.text.tsl9_feature_handler_1537a))
    KEEP(*(.text.tsl9_feature_handler_1537e))
    KEEP(*(.text.tsl9_feature_handler_15382))
    KEEP(*(.text.tsl9_feature_handler_1538a))
    KEEP(*(.text.tsl9_feature_handler_15390))
    KEEP(*(.text.tsl9_feature_handler_15394))
    KEEP(*(.text.tsl9_feature_handler_1539a))
    KEEP(*(.text.tsl9_feature_handler_1539e))
    KEEP(*(.text.tsl9_feature_handler_153a6))
    KEEP(*(.text.tsl9_feature_handler_153ac))
    KEEP(*(.text.tsl9_feature_handler_153b0))
    KEEP(*(.text.tsl9_feature_handler_153b4))
    KEEP(*(.text.tsl9_feature_outer_153ba))
    KEEP(*(.text.tsl9_feature_outer_153ce))
    KEEP(*(.text.tsl9_feature_outer_153da))
    KEEP(*(.text.tsl9_feature_outer_153ee))
    KEEP(*(.text.tsl9_feature_outer_153fa))
    KEEP(*(.text.tsl9_feature_outer_15416))
    KEEP(*(.text.tsl9_feature_outer_15422))
    KEEP(*(.text.tsl9_feature_outer_1542e))
    KEEP(*(.text.tsl9_feature_outer_1543a))
    KEEP(*(.text.tsl9_feature_outer_15456))
    KEEP(*(.text.tsl9_feature_outer_15462))
    KEEP(*(.text.tsl9_feature_outer_1546e))
    KEEP(*(.text.tsl9_feature_outer_1547a))
    KEEP(*(.text.tsl9_feature_outer_1548e))
    KEEP(*(.text.tsl9_feature_outer_1549a))
    KEEP(*(.text.tsl9_feature_outer_1549e))
  }
  ASSERT(SIZEOF(.feature_graph) == 5088, "Genuine3166 prefix plus1922 C source bytes")
  .table_0 : ALIGN(4) { KEEP(*(.rodata.tsl9_feature_mode_table_1a6b8)) }
  ASSERT(SIZEOF(.table_0) == 28, "Exact table extent")
  .table_1 : ALIGN(4) { KEEP(*(.rodata.tsl9_feature_nested_table)) }
  ASSERT(SIZEOF(.table_1) == 32, "Exact table extent")
  /DISCARD/ : { *(.comment) *(.note*) *(.riscv.attributes) }
}
